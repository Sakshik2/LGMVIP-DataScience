/*
   Author: Sakshi Kshirsagar
   Reviewer: Prasad Sawant
   Firmware Version: 1.1
   Firmware Date: 03/04/2025
   Flow Chart:
   
   1) After power on, current user is shown on screen, skipping optio is available.
   2) For new user, settings can be done using Payment Box app using bluetooth.
      parameters for user- Bank details and UPI details (bank name, last 4 AC no.)(UPI ID, User name, Currency).
   3) Network connection, configuring cellular with AT commands.
   4) QR code, user details, bank details are set for current user.
   5) QR code with specified amount is generated by taking input from keypad and bluetooth.
   6) 1 min. timer is there for generated QR code.
   7) Updating the transaction after receiving message, giving alert with audio and showing on screen.
*/

#include<Preferences.h>
Preferences pref;
#include <HardwareSerial.h>
#include <SPI.h>
#include <ArduinoJson.h>
#include <BluetoothSerial.h>
#include <Arduino.h>
#include <Wire.h>
#include "Audio.h"
#include <SD.h>
#include <SoftwareSerial.h>
#include <FS.h>
#include <SPIFFS.h>
#include <BLEDevice.h>
#include <BLEServer.h>
#include <BLEUtils.h>
#include <BLE2902.h>
#include <driver/adc.h>

#define SERVICE_UUID        "6E400001-B5A3-F393-E0A9-E50E24DCCA9E"                // UART service UUID
#define CHARACTERISTIC_UUID_RX "6E400002-B5A3-F393-E0A9-E50E24DCCA9E"             // RX characteristic UUID
#define CHARACTERISTIC_UUID_TX "6E400003-B5A3-F393-E0A9-E50E24DCCA9E"             // TX characteristic UUID

#include <DWIN.h>
#define DGUS_SERIAL Serial1
DWIN hmi(DGUS_SERIAL, 26, 25, 115200);
HardwareSerial dwinSerial(1);

/**************************** // General-purpose I/O pins  ************************************/
#define GPIO0  0    // Boot mode selection, often used as a button or input.
#define GPIO1  1    // UART0 TX, can also be used as a general-purpose I/O.
#define GPIO2  2    // UART0 RX, can also be used as a general-purpose I/O.
#define GPIO3  3    // UART0 RX, can also be used as a general-purpose I/O.
#define GPIO4  4    // General-purpose I/O, used in various functions.
#define GPIO5  5    // General-purpose I/O, often used for SPI CS or other functions.
#define GPIO6  6    // Typically used for the internal flash memory; not recommended for general use.
#define GPIO7  7    // Typically used for the internal flash memory; not recommended for general use.
#define GPIO8  8    // Typically used for the internal flash memory; not recommended for general use.
#define GPIO9  9    // Typically used for the internal flash memory; not recommended for general use.
#define GPIO10 10   // Typically used for the internal flash memory; not recommended for general use.
#define GPIO11 11   // Typically used for the internal flash memory; not recommended for general use.
#define GPIO12 12   // General-purpose I/O, also used for boot mode selection.
#define GPIO13 13   // General-purpose I/O, often used for SPI or other functions.
#define GPIO14 14   // General-purpose I/O, often used for SPI or other functions.
#define GPIO15 15   // General-purpose I/O, also used for boot mode selection.
#define GPIO16 16   // General-purpose I/O, used in various functions.
#define GPIO17 17   // General-purpose I/O, used in various functions.
#define GPIO18 18   // SPI CLK, can also be used as a general-purpose I/O.
#define GPIO19 19   // SPI MISO, can also be used as a general-purpose I/O.
#define GPIO20 20   // General-purpose I/O, not always available.
#define GPIO21 21   // I2C SDA, can also be used as a general-purpose I/O.
#define GPIO22 22   // I2C SCL, can also be used as a general-purpose I/O.
#define GPIO23 23   // SPI MOSI, can also be used as a general-purpose I/O.
#define GPIO24 24   // General-purpose I/O, used in various functions.
#define GPIO25 25   // DAC1 output, also used as a general-purpose I/O.
#define GPIO26 26   // DAC2 output, also used as a general-purpose I/O.
#define GPIO27 27   // General-purpose I/O, used in various functions.
#define GPIO28 28   // General-purpose I/O, not always available.
#define GPIO29 29   // General-purpose I/O, not always available.
#define GPIO30 30   // General-purpose I/O, not always available.
#define GPIO31 31   // General-purpose I/O, not always available.
#define GPIO32 32   // ADC1 input, also used as a general-purpose I/O.
#define GPIO33 33   // ADC1 input, also used as a general-purpose I/O.
#define GPIO34 34   // Input-only, often used for ADC.
#define GPIO35 35   // Input-only, often used for ADC.
#define GPIO36 36   // Input-only, often used for ADC, also known as VP (Voltage Reference Pin).
#define GPIO37 37   // Input-only, often used for ADC.
#define GPIO38 38   // Input-only, often used for ADC.
#define GPIO39 39   // Input-only, often used for ADC, also known as VN (Negative Voltage Pin).

/**************************** USED PINS ************************************/

/**************************** MICRO SD CARD PINS ************************************/
/* BOARD 1*/
#define SD_CS     5 //14
#define SPI_MOSI  18 //21
#define SPI_MISO  32 //33
#define SPI_SCK   19//13

/**************************** I2S AUDIO AMPLIFIRE PINS ************************************/
/* BOARD 1*/
#define I2S_DOUT  15 //27
#define I2S_BCLK  2  //26
#define I2S_LRC  4   //25

/**************************** SIM800L GSM PINS     ************************************/
/* BOARD 1*/
#define TX_PIN        17
#define RX_PIN        16
#define DWIN_TX       25
#define DWIN_RX       26

/**************************** PREV BUTTON PIN  ************************************/
/* BOARD 1*/
#define BUTTON_PIN 35 // Define the button pin for accessing previous transactions
#define pwr_key 23
#define increaseVol_PIN 36
#define decreaseVol_PIN 39
const int batteryPin = 34; // Define the analog pin connected to the battery voltage

/****************************DWIN Display VP Addresses****************************************/
#define BLE_Add 0x61
#define DEF_UPI 0x62
#define AMT_UPI 0x63
#define TIME 0x64
#define CURRENT_PAY 0x65
#define PRE_PAY 0x66
#define DEF_QR 0x11
#define AMT_QR 0x12
#define AMT_INPUT 0x10
#define BAT_ADD 0x68
#define NET_ICON 0x55
#define AMOUNT 0x67
#define ble_add 0x56

/**************************** Commands for DWIN display ******************************************/
int32_t reset = 0;
unsigned char ResetAmt[11] = {0x5a, 0xa5, 0x07, 0x82, 0x10 , 0x00, 0x00, (reset >> 24) & 0xFF, (reset >> 16) & 0xFF, (reset >> 8) & 0xFF, reset & 0xFF};
uint8_t terminator[3] = {0xFF, 0xFF, 0xFF};
unsigned char offDisplay[7] = {0x5A, 0xA5, 0x04, 0x82, 0x00, 0X82, 0X00};                         // 0%
unsigned char onDisplay[7] = {0x5A, 0xA5, 0x04, 0x82, 0x00, 0X82, 0X5A};                          //90%
unsigned char standDisplay[7] = {0x5A, 0xA5, 0x04, 0x82, 0x00, 0X82, 0X28};                       //40%
unsigned char standbyMode[10] = {0x5A, 0xA5, 0x07, 0x82, 0x00, 0x82, 0x64, 0x14, 0x03, 0xE8};     // setting 20% brightness
unsigned char displayRTC[14] = {0x5A, 0xA5, 0x0B, 0x82, 0x00, 0x10, 0x13, 0x0A, 0x01, 0x00, 0x0B, 0x0C, 0x0D, 0x00};
unsigned char simulateTouch[14] = {0x5A, 0xA5, 0x0B, 0x82, 0x00, 0xD4, 0x5A, 0xA5, 0x00, 0x04, 0x00, 0xEE, 0x00, 0x8F};

/**************************** Create Bluetooth and Audio objects  ************************************/
Audio audio;
BluetoothSerial SerialBT;

// Initialize SPI for SD card on HSPI
SPIClass hspi(HSPI);

/**************************** variable declarations ************************************/
#define UART_BAUD 115200                                                          // Baud rate for DWIN display
#define FORMAT_SPIFFS_IF_FAILED true
hw_timer_t *timer = NULL;
hw_timer_t *timer1 = NULL;

//BLE variables
BLECharacteristic *pCharacteristic;
BLEServer *pServer = nullptr;
BLECharacteristic *pTxCharacteristic;
bool bleMode = false;
#define PASSKEY 654321
#define PASSWORD   "Embel01"
unsigned long bluetoothStartTime;
const unsigned long bluetoothDuration = 2 * 60 * 1000;                       // 2 minutes in milliseconds
volatile bool Connected = false;
volatile bool Parameter_flag = false;
volatile bool Password_flag = false;
volatile bool Timeout_flag = false;
volatile bool Exit_flag = false;
char Recieved[100] = "abcd";
unsigned long startTime;
bool time_up = false;
bool bleFlag = false;

//User configuration variables
String deviceConfig = "";
String bankName = "";
String bankID = "";
String bankID_4 = "";
String upiID = "";
String userName = "";
String currency = "";
String apnname = "";

//bool m_connection = false;

//ESP32 sleep mode handling variables
int TIME_TO_SLEEP = 5;
#define uS_TO_S_FACTOR 1000000ULL
bool wakeupFlag = 0; //flag for indicating RTC wakeup

//previous button interrupt
#define debounceTime 900
unsigned long lastInterruptTime;
volatile bool Button_flag = false;

//Message handling variables
String finalKeypadAmount = "";                                               // keypad input
bool isAmount = false;
String final_amount = "";
String response = "";
char* lower = "12341197";
char* promsg = "";
char* msg = "+cmt: \"8446100765\"";
String date = "";
String preTime = "";

//BLE amount input handling variables
float amount = 0;
char amount_File[] = "/amount.txt";
int fs_size = 0;

//Previous button specific transaction access variables
volatile int Button_cnt = 0;
int Msg_cnt = 0;

//Variables for handling generated QR code
unsigned long previousMillis = 0;
unsigned long interval = 1000;                                              // Interval for 1 second
int countdownTime = 0;                                                      // Countdown time in seconds

int currentVolume = 100;
bool increaseVol = false, decreaseVol = false;
byte pageno;
bool audioPlaying = false;
bool networkAvailable = false;
bool power_on_cellular = false;
//unsigned long int charge_check = 0;

/**************************** // Flags to track if the messages have been printed ************************************/
//bool lastButtonState = HIGH;                                              // Track the last button state
bool lowBatteryMessagePrinted = false;
bool fullBatteryMessagePrinted = false;

/***************** Message Buffer ****************************/
#define BUFFER_SIZE 100                                                    // for handling multiple messages
String messageBuffer[BUFFER_SIZE];
int index1 = 0;

/********** BATTERY MANAGEMENTS RELATED VARIABLES ***********/
const float referenceVoltage = 3.3;                                        // Reference voltage of ESP32 ADC
const int adcMaxValue = 4095;                                              // Maximum ADC value for 12-bit resolution
// Battery voltage range
const float minBatteryVoltage = 1.3;                                       // Minimum battery voltage for 0% charge (adjust as needed)
const float maxBatteryVoltage = 2.1;                                       // Maximum battery voltage for 100% charge (adjust as needed)
// Thresholds for battery percentage
const float lowThreshold = 25.0;                                           // Below 20% is considered low
const float mediumThreshold = 50.0;                                        // 50% and above is considered medium
const float fullThreshold = 100.0;                                          // 90% and above is considered full
unsigned long bat_cal = 0;
int checktp = 5;
int ADCvalue;
float batvoltage;
int batperc;
float batt_level = 0;
bool chargingOn = false;

// Variable to store the last battery status
String lastBatteryStatus = "";
int counter = 0; int check_tp = 30;

#define Serial Serial
// Define the serial port to be used for debugging and monitoring
// This typically maps to the USB serial connection

#define DUMP_AT_COMMANDS
// Define this macro to enable debugging of AT commands
// Comment this out if AT command debugging is not needed

#define TINY_GSM_DEBUG Serial
// Set the debug output for the TinyGSM library to use the Serial port
// This enables logging of library debug information to the serial monitor

#define TINY_GSM_MODEM_SIM800
// Define the modem type as SIM800
// This configures the TinyGSM library to use the SIM800 modem

#define TINY_GSM_RX_BUFFER 1024
// Set the receive buffer size for the TinyGSM library
// This allocates 1KB of memory for the RX buffer to store incoming data

#include <TinyGsmClient.h>
// Include the TinyGSM library header
// This library provides functionality for communicating with GSM modems

// Set serial port for AT commands (to communicate with the GSM module)
#define Serial2 Serial2
// Define Serial2 for communicating with the GSM module
// On most boards, Serial2 maps to specific hardware UART pins

SoftwareSerial mySoftwareSerial(RX_PIN, TX_PIN);
// Create a SoftwareSerial object for communication with the GSM module
// GSM_RX and GSM_TX are the pin definitions for receive and transmit

#ifdef DUMP_AT_COMMANDS
#include <StreamDebugger.h>
// Include the StreamDebugger library if DUMP_AT_COMMANDS is defined
// This library provides functionality to log and debug AT commands

StreamDebugger debugger(Serial2, Serial);
// Create a StreamDebugger object that wraps the Serial2 and Serial
// This allows for debugging AT commands sent to and received from the modem

TinyGsm modem(debugger);
// Initialize the TinyGsm modem object using the debugger stream
#else
TinyGsm modem(Serial2);
// Initialize the TinyGsm modem object using the Serial2 port directly
#endif

/**************************** BLE CLASSIC  ************************************/
void IRAM_ATTR onTimer1() {                                                                   // skipping user configuration
  Serial.println("No response for user for setting configuration, previous user is selected");
  time_up = true;
}

void IRAM_ATTR onTimer() {                                                                   // bluetooth
  Serial.println("No connection within 2 minutes. Deinitializing BLE...");
  /*timerAlarmDisable(timer);
    Serial.println("Timer stopped.");
    Serial.println("Timer triggered!");
    timerAlarmDisable(timer);
    Serial.println("Timer stopped.");*/
  Timeout_flag = true;
}

void IRAM_ATTR Buttonhandler() {                                                           // previous button handler timing
  timerAlarmDisable(timer);
  //#timerAlarmDisable(timer);
  //#Serial.print("Button_cnt is :");
  //#Serial.println(Button_cnt);
  Button_flag = true;
}

void IRAM_ATTR buttonPress() {                                                            // previous button press handler
  unsigned long currentTime = millis();
  if ((currentTime - lastInterruptTime) > debounceTime) {
    Serial.println("IRAM_ATTR buttonPress :###############");

    if (Button_cnt == 0) {
      timer = timerBegin(0, 80, true);                                                   // Timer 0, prescaler 80, counting up
      timerAttachInterrupt(timer, &Buttonhandler, true);
      timerAlarmWrite(timer, 1000000, true);                                             // Trigger every 6 seconds
      timerAlarmEnable(timer);
    }
    Button_cnt++;
    lastInterruptTime = currentTime;

  }
}

void IRAM_ATTR increasePress() {                                                            // previous button press handler
  unsigned long currentTime = millis();
  if ((currentTime - lastInterruptTime) > 20) {
    Serial.println("increase volume button");
    increaseVol = true;                                                                    // setting flag to complete action
    lastInterruptTime = currentTime;

  }
}

void IRAM_ATTR decreasePress() {                                                            // previous button press handler
  unsigned long currentTime = millis();
  if ((currentTime - lastInterruptTime) > 20) {
    Serial.println("decrease volume button");
    decreaseVol = true;                                                                   // setting flag to complete action
    lastInterruptTime = currentTime;

  }
}

class MyServerCallbacks : public BLEServerCallbacks {
    void onConnect(BLEServer* pServer) {
      Serial.println("Client Connected!");
      pServer->startAdvertising();
    }

    void onDisconnect(BLEServer* pServer) {
      Serial.println("Client Disconnected!");
      //delay(100);
      // Restart advertising after disconnection
      pServer->startAdvertising();
      startTime = millis();                                                                     // Reset the timeout
      audioPlayer(1007);
    }
};

class SecurityCallback : public BLESecurityCallbacks {
    uint32_t onPassKeyRequest() {
      return 000000;
    }
    void onPassKeyNotify(uint32_t pass_key) {}
    bool onConfirmPIN(uint32_t pass_key) {
      vTaskDelay(2000);
      return true;
    }
    bool onSecurityRequest() {
      return true;
    }
    void onAuthenticationComplete(esp_ble_auth_cmpl_t cmpl) {
      if (cmpl.success) {
        Serial.println("   - SecurityCallback - Authentication Success");
        //delay(1000);
        audioPlayer(1005);                                                                   //Bluetooth Connected audio
        Connected = true;
      } else {
        Serial.println("   - SecurityCallback - Authentication Failure*");
        Connected = false;
        //pServer->removePeerDevice(pServer->getConnId(), true);
      }
      BLEDevice::startAdvertising();
    }
};

class MyCallbacks : public BLECharacteristicCallbacks {
    void onWrite(BLECharacteristic *pCharacteristic) {
      std::string rxValue = pCharacteristic->getValue();
      if (rxValue.length() > 0)
      {
        Serial.print("## Received Value: ") ;
        Serial.println(String(rxValue.c_str()));
        for (int i = 0; i < rxValue.length(); i++)
        {
          Recieved[i] = rxValue[i];                                                               // Receiving data from bluetooth
        }
        Parameter_flag = true;
      }
    }
};

void ble_init_param_set_fun()
{
  BLEDevice::init("EMBEL-PAYTEM 05"); // Give it a name
  BLEDevice::setEncryptionLevel(ESP_BLE_SEC_ENCRYPT);
  BLEDevice::setSecurityCallbacks(new SecurityCallback());
  BLEServer *pServer = BLEDevice::createServer();
  pServer->setCallbacks(new MyServerCallbacks());
  BLEService *pService = pServer->createService(SERVICE_UUID);
  pCharacteristic = pService->createCharacteristic(
                      CHARACTERISTIC_UUID_TX,
                      BLECharacteristic::PROPERTY_READ | BLECharacteristic::PROPERTY_NOTIFY
                    );
  pCharacteristic->addDescriptor(new BLE2902());
  pCharacteristic->setCallbacks(new MyCallbacks());
  BLECharacteristic *pCharacteristic = pService->createCharacteristic(
                                         CHARACTERISTIC_UUID_RX,
                                         BLECharacteristic::PROPERTY_WRITE
                                       );

  pCharacteristic->setAccessPermissions(ESP_GATT_PERM_READ_ENCRYPTED | ESP_GATT_PERM_WRITE_ENCRYPTED);
  pCharacteristic->setCallbacks(new MyCallbacks());
  pService->start();
  pServer->getAdvertising()->start();
  Serial.println("WELCOME ");
  bleSecurity();
}

void bleSecurity() {
  esp_ble_auth_req_t auth_req = ESP_LE_AUTH_REQ_SC_MITM_BOND;
  esp_ble_io_cap_t iocap = ESP_IO_CAP_OUT;
  uint8_t key_size = 16;
  uint8_t init_key = ESP_BLE_ENC_KEY_MASK | ESP_BLE_ID_KEY_MASK;
  uint8_t rsp_key = ESP_BLE_ENC_KEY_MASK | ESP_BLE_ID_KEY_MASK;
  uint32_t passkey = PASSKEY;
  uint8_t auth_option = ESP_BLE_ONLY_ACCEPT_SPECIFIED_AUTH_DISABLE;
  esp_ble_gap_set_security_param(ESP_BLE_SM_SET_STATIC_PASSKEY, &passkey, sizeof(uint32_t));
  esp_ble_gap_set_security_param(ESP_BLE_SM_AUTHEN_REQ_MODE, &auth_req, sizeof(uint8_t));
  esp_ble_gap_set_security_param(ESP_BLE_SM_IOCAP_MODE, &iocap, sizeof(uint8_t));
  esp_ble_gap_set_security_param(ESP_BLE_SM_MAX_KEY_SIZE, &key_size, sizeof(uint8_t));
  esp_ble_gap_set_security_param(ESP_BLE_SM_ONLY_ACCEPT_SPECIFIED_SEC_AUTH, &auth_option, sizeof(uint8_t));
  esp_ble_gap_set_security_param(ESP_BLE_SM_SET_INIT_KEY, &init_key, sizeof(uint8_t));
  esp_ble_gap_set_security_param(ESP_BLE_SM_SET_RSP_KEY, &rsp_key, sizeof(uint8_t));
}

#define BUTTON_PIN_BITMASK 0x200000000 // 2^33 in hex

/*
  Method to print the reason by which ESP32
  has been awaken from sleep
*/
void print_wakeup_reason() {
  esp_sleep_wakeup_cause_t wakeup_reason;
  wakeup_reason = esp_sleep_get_wakeup_cause();
  switch (wakeup_reason)
  {
    case ESP_SLEEP_WAKEUP_EXT0 : Serial.println("Wakeup caused by external signal using RTC_IO");
      wakeupFlag = true; break;
    case ESP_SLEEP_WAKEUP_EXT1 : Serial.println("Wakeup caused by external signal using RTC_CNTL"); break;
    case ESP_SLEEP_WAKEUP_TIMER : Serial.println("Wakeup caused by timer");
      wakeupFlag = true; break;
    case ESP_SLEEP_WAKEUP_TOUCHPAD : Serial.println("Wakeup caused by touchpad"); break;
    case ESP_SLEEP_WAKEUP_ULP : Serial.println("Wakeup caused by ULP program"); break;
    default : Serial.printf("Wakeup was not caused by deep sleep: %d\n", wakeup_reason); break;
  }
}

void setup() {
  Serial.begin(115200);
  /*********************setting RTC wakeup and printing wakeup cause**************************************/
  esp_sleep_enable_ext0_wakeup(GPIO_NUM_26, 0);                                // Seeting ext0 wakeup at RTC pin 26
  print_wakeup_reason();
  //Setting UNUSED GPIOs
  pinMode(0, INPUT);
  digitalWrite(0, LOW);
  pinMode(12, OUTPUT);
  digitalWrite(12, LOW);
  pinMode(13, OUTPUT);
  digitalWrite(13, LOW);
  pinMode(14, OUTPUT);
  digitalWrite(14, LOW);
  pinMode(20, INPUT_PULLDOWN);
  pinMode(22, OUTPUT);
  digitalWrite(22, LOW);
  pinMode(24, INPUT_PULLDOWN);
  pinMode(27, OUTPUT);
  digitalWrite(27, LOW);
  pinMode(28, INPUT_PULLDOWN);
  pinMode(29, INPUT_PULLDOWN);
  pinMode(30, INPUT_PULLDOWN);
  pinMode(31, INPUT_PULLDOWN);
  pinMode(33, OUTPUT);
  digitalWrite(33, LOW);
  pinMode(37, INPUT_PULLDOWN);
  pinMode(38, INPUT_PULLDOWN);

  pinMode(21, INPUT_PULLUP);                                                 // Battery charging status pin
  pinMode(batteryPin, INPUT);
  pinMode(pwr_key, OUTPUT);
  // Set microSD Card CS as OUTPUT and set HIGH
  pinMode(SD_CS, OUTPUT);
  digitalWrite(SD_CS, HIGH);

  pinMode(BUTTON_PIN, INPUT_PULLUP);
  pinMode(36, INPUT_PULLUP);
  pinMode(39, INPUT_PULLUP);
  digitalWrite(36, HIGH);
  digitalWrite(39, HIGH);
//  attachInterrupt(BUTTON_PIN, buttonPress, FALLING);                         // Interrupt for previous readings 
//  attachInterrupt(36, increasePress, FALLING);
//  attachInterrupt(39, decreasePress, FALLING);

  pref.begin("data", false);

  
  
  dwinSerial.begin(UART_BAUD, SERIAL_8N1, DWIN_RX, DWIN_TX);                 //DWIN DISPLAY
  Serial2.begin(115200, SERIAL_8N1, 16, 17);                                 //EC200U

  Serial.println("Process stareted");
  setPage(00);
  dwinSerial.write(simulateTouch, 14);
  battery_measurement();
  Serial.println(batperc);

  /************************* Checking battery charging status *******************************************/
  if (digitalRead(21) == LOW) {                   
    chargingOn = true;
    chargingStatus(chargingOn);
  }
  else if (digitalRead(21) == HIGH) {
    chargingOn = false;
    chargingStatus(chargingOn);
  }

  /********************Check for battery status***************************************/
  if (batperc < 17.00) {
    Serial.println("Entering in sleep mode!!!");

    esp_sleep_enable_timer_wakeup((TIME_TO_SLEEP * 60) * uS_TO_S_FACTOR);     // Wake up ESP32 after 5 minutes for checking battery status
    Serial.println("Low Battery, Entering sleep mode!!");
    setPage(11);
    Serial.flush();
    delay(2000);
    dwinSerial.write(offDisplay, 7);
    esp_deep_sleep_start();
  }
  

  Serial.println("## CODE IS STARTED NOW.............................");
  /**************************** // Initialize the SPIFFS ************************************/
  // Initialize SPIFFS
  if (!SPIFFS.begin(FORMAT_SPIFFS_IF_FAILED)) {
    Serial.println("SPIFFS Mount Failed");
    return;
  }
  Serial.println("SPIFFS initialized successfully.");
  readUpidetails();                                                             // Reading previous user details

  /**************************** // Initialize the SD CARD ************************************/
  // Initialize SPI bus for microSD Card
  hspi.begin(SPI_SCK, SPI_MISO, SPI_MOSI, SD_CS);
  if (!SD.begin(SD_CS, hspi)) {
    Serial.println("Error accessing microSD card!");
    while(1);
    //return;
  }
  //Serial.begin(115200);
  Serial.println("SD card initialized.");
  displayBattery();

  /**************************** // Initialize the I2S ************************************/
  // Setup I2S
  audio.setPinout(I2S_BCLK, I2S_LRC, I2S_DOUT);
  // Set Volume
  audio.setVolume(currentVolume);

  if (wakeupFlag) {                                                               // If wakeup happen
    dwinSerial.write(onDisplay, 7);
    pageno = pref.getInt("pageno", pageno);
    setPage(pageno);
    Serial2.println("AT");
    updateSerial();
    Serial2.println("AT+CFUN=1");                                                 // setting cellular to full functionality
    updateSerial();
    setPage(18);
    Serial.print("Checking BLE mode ");
    bleMode = pref.getBool("BLE", bleMode);
    Serial.println(bleMode);

    if (bleMode) {
      ble_init_param_set_fun();
    }
  }

  if (!wakeupFlag) {                                                              // powering on the system
    audioPlayer(1001);                                                            // poweron audio
    hmi.echoEnabled(false);
    Serial.println("## CODE IS STARTED NOW.............................");
    dwinSerial.write(onDisplay, 7);
    //setPage(00);
    displayNetwork(false);
    displayBle(false);

    /**************************** // Initialize the TFT screen  ************************************/
    Serial.println("Setting welcome page");
    displayBattery();
    //audioPlayer(1002);                                                         // Embel audio
    audioPlayer(1015);                                                           // Vishwaguru audio
    Serial.println("Welcome page displayed.");
    readUpidetails();                                                            // Reading previous user details

    if (bankName != "" && bankID != "") {
      sendTextAscii(0x31, userName);
      sendTextAscii(0x53, upiID);
      sendTextAscii(0x32, bankName);
      //sendTextAscii(0x56, "AC No.: ");
      sendTextAscii(0x57, "XX" + bankID_4);
      sendTextAscii(0x28, "  " + userName);
      sendTextAscii(0x42, "  " + upiID);
      setPage(15);                                                                // Displaying current user
      delay(1000);
      Serial.println("Select user");
      dwinSerial.write(simulateTouch, 14);

      timer1 = timerBegin(0, 80, true);                                          // Timer 0, prescaler 80, counting up
      // Attach the interrupt handler
      timerAttachInterrupt(timer1, &onTimer1, true);
      // Set the timer alarm to trigger every 1 second (1,000,000 microseconds)
      timerAlarmWrite(timer1, 30000000, true); // 10 sec                         // 30 sec timer for skipping configuration
      // Start the timer
      timerAlarmEnable(timer1);

      while (!time_up) {
        if (hmi.getPage() == 1) {
          timerAlarmDisable(timer1);
          Serial.println("Timer stopped.");
          bleFlag = true;
          sendTextAscii(BLE_Add, "  Pairing... ");
          break;
        }
        else if (hmi.getPage() == 12) {
          timerAlarmDisable(timer1);
          Serial.println("Timer stopped.");
          break;
        }
        if (digitalRead(21) == LOW) {
          chargingOn = true;
          chargingStatus(chargingOn);
        }
        else if (digitalRead(21) == HIGH) {
          chargingOn = false;
          chargingStatus(chargingOn);
        }
      }

      timerAlarmDisable(timer1);
      Serial.println("Timer stopped.");
      time_up = false;
    }

    else {
      setPage(01);                                                               // Setting BLE page for setting user details
      bleFlag = true;
      sendTextAscii(BLE_Add, "  Pairing... ");
    }

    /**************************** BLE Connection ************************************/
    if (bleFlag) {
      displayBle(true);
      ble_init_param_set_fun();
      // Set up a hardware timer
      timer = timerBegin(0, 80, true);                                            // Timer 0, prescaler 80, counting up
      // Attach the interrupt handler
      timerAttachInterrupt(timer, &onTimer, true);
      // Set the timer alarm to trigger every 1 second (1,000,000 microseconds)
      timerAlarmWrite(timer, 120000000, true);
      // Start the timer
      timerAlarmEnable(timer);

      Serial.println("Waiting for Connection");
      sendTextAscii(0x69, "Set User Within 2 Min.");
      displayBattery();
      bleMode = true;

      while (!(Connected) && !(Timeout_flag))
      {
        //Serial.println("Connection");
        vTaskDelay(10 / portTICK_PERIOD_MS);                                     // Wait for 10ms and yield control
      }
      if (Connected)
      {
        eraseText(BLE_Add, 15);
        sendTextAscii(BLE_Add, " CONNECTED");
        //delay(2500);
        audioPlayer(1006);                                                       //Bluetooth Configuration audio
      }

      Serial.println("Connection-waiting for 2nd authentication password");
      while (!(Parameter_flag) && !(Timeout_flag))
      {
        String response = "\n Enter Ur password to set UPI details";
        Serial.println("## Sent data  is : " + response);
        pCharacteristic->setValue(response.c_str());
        pCharacteristic->notify();
        vTaskDelay(2000 / portTICK_PERIOD_MS);                                   // Wait for 10ms and yield control
      }
      delay(1000);
      Parameter_flag = false;
      while (!(Password_flag) && !(Timeout_flag))
      {
        passwordVerification();
        vTaskDelay(2000 / portTICK_PERIOD_MS);                                   // Wait for 2000ms and yield control
      }
      delay(1000);
      Serial.println("Connection-waiting for responce1");
      String response1 = "\n Enter Ur Bank ID and bank account number with this fomat: bank_name,bank_accountno";
      Serial.println("## Sent data  is : " + response1);
      pCharacteristic->setValue(response1.c_str());
      pCharacteristic->notify();
      Parameter_flag = false;
      while (!(Parameter_flag) && !(Timeout_flag))
      {
        vTaskDelay(10 / portTICK_PERIOD_MS);                                     // Wait for 10ms and yield control
      }
      getAcc_details();
      delay(1000);
      String response2 = "\n Enter UPI details with this format only: upi_id,user name,currency";
      Serial.println("## Sent data  is : " + response2);
      pCharacteristic->setValue(response2.c_str());
      pCharacteristic->notify();
      Parameter_flag = false;
      Serial.println("Connection-waiting for responce2");
      while (!(Parameter_flag) && !(Timeout_flag))
      {
        vTaskDelay(10 / portTICK_PERIOD_MS);                                       // Wait for 10ms and yield control
      }
      getUpi_details();
      delay(1000);
      String response4 = "\n Enter APN details with this format only: APN_name";
      Serial.println("## Sent data  is : " + response4);
      pCharacteristic->setValue(response4.c_str());
      pCharacteristic->notify();
      Parameter_flag = false;
      Serial.println("Connection-waiting for responce4");
      while (!(Parameter_flag) && !(Timeout_flag))
      {
        vTaskDelay(10 / portTICK_PERIOD_MS);                                                 // Wait for 10ms and yield control
      }
      getApn_details();
      delay(1000);
      String response3 = "\n Please select configuration for device(BLE/GSM).USE FOR GSM:1,BLE:2";
      Serial.println("## Sent data  is : " + response3);
      pCharacteristic->setValue(response3.c_str());
      pCharacteristic->notify();
      Parameter_flag = false;
      Serial.println("Connection-waiting for responce3");
      while (!(Parameter_flag) && !(Timeout_flag))
      {
        vTaskDelay(10 / portTICK_PERIOD_MS);                                                 // Wait for 10ms and yield control
      }
      getConfig_details();
      if ((strstr(deviceConfig.c_str(),  "1")) || (Timeout_flag))
      {
        Serial.println("CONFIGURATION SELECTED FOR DEVICE IS : GSM");
        displayBle(false);
        bleMode = false;
        // Stop advertising
        pServer->getAdvertising()->stop();
        Serial.println("getAdvertising stopped.");

        if (Connected == true) {
          eraseText(BLE_Add, 15);
          sendTextAscii(BLE_Add, "DISCONNECTED");

          // Deinitialize BLE
          Serial.println("** BLE deinit function ");
          BLEDevice::deinit();                                                              // Bluetooth deinitialization
          //delay(500);

          //20sept  audioPlayer(1007);
        }
      }
      else
      {
        Serial.println("CONFIGURATION SELECTED FOR DEVICE IS : BLE");
        displayBle(true);
        bleMode = true;
        pref.putBool("BLE", bleMode);
      }
      timerAlarmDisable(timer);
      Serial.println("Timer stopped.");
      timerAlarmDisable(timer);
      eraseText(0x69, 20);
      Parameter_flag = false;
      Timeout_flag = false;

      if (Password_flag)
      {
        writeUpidetails();                                                                  // Writing user details in SPIFF
        Connected = false;
      }

      readUpidetails();                                                                     // Reading user details in SPIFF
      audioPlayer(1014);                                                                    // User configuration set audio
      getMsgcnt();
      eraseText(BLE_Add, 15);
    }


  
    if (digitalRead(21) == LOW) {                                                          // Checking battery charging status
      chargingOn = true;
      chargingStatus(chargingOn);
    }
    else if (digitalRead(21) == HIGH) {
      chargingOn = false;
      chargingStatus(chargingOn);
    }

    getMsgcnt();                                                                             // Getting message count
    battery_measurement();
    displayBattery();
    setPage(12);                                                                            //Network connecting PAGE WITHOUT NETWORK AND BATTERY SYMBOL
    Serial.println("Initializing modem...");
    dwinSerial.write(simulateTouch, 14);
    Serial2.println("AT");
    updateSerial();
    if (response == "OK") {
      power_on_cellular = true;
    }
    if (digitalRead(21) == LOW) {                                                         // Checking battery charging status
      chargingOn = true;
      chargingStatus(chargingOn);
    }
    else if (digitalRead(21) == HIGH) {
      chargingOn = false;
      chargingStatus(chargingOn);
    }

    /****************Power on sequence for cellular****************************/
    if (!power_on_cellular) {
      delay(50);
      Serial.println("Powering on the cellular module");
      digitalWrite(pwr_key, HIGH);                                                       // Holding pwr key for on the cellular
      delay(2500);
      digitalWrite(pwr_key, LOW);
      //delay(90000);
      delay(2000);
      Serial.println("Power on sequence completed");
    }

    Serial.println("Waiting for network...");
    char data1[50] = {0};
    sprintf(data1, "AT+CGDCONT=1,\"IP\",\"%s\"", apnname.c_str());                      //APN setting
    Serial.println(apnname);
    Serial.println(data1);
    Serial2.println(data1);
    updateSerial();
    if (!modem.waitForNetwork(30000L)) {
      delay(10000);
      //return;
    }
    if (modem.isNetworkConnected()) {
      displayNetwork(true);
      audioPlayer(1003);
      networkAvailable = true;
      Serial.println("Network connected");
    }

    configModule();//Configurring cellular module with AT commands

    Serial.println("Modem configured for SMS.");
    audioPlayer(10012);//ADD AUDIO FOR DEVICE IS READY TO USE

    if (digitalRead(21) == LOW) {
      chargingOn = true;
      chargingStatus(chargingOn);
    }
    else if (digitalRead(21) == HIGH) {
      chargingOn = false;
      chargingStatus(chargingOn);
    }

    sendTextAscii(0x31, userName);
    sendTextAscii(0x53, upiID);
    sendTextAscii(0x32, bankName);
    //sendTextAscii(0x56, "AC No.: ");
    sendTextAscii(0x57, "XX" + bankID_4);
    sendTextAscii(0x28, "  " + userName);

    displaytransaction();                                                     //displaying transaction history on screen

    hmi.setPage(18);                                                          //default QR page
    sendTextAscii(DEF_UPI, upiID);                                            //sending UPI Id on default QR page
    sendTextAscii(AMT_UPI, upiID);                                            //sending UPI Id on dynamic QR page
    eraseText(0x33, 20);                                                      //Clearing the string before setting new
    sendTextAscii(0x33, "Transaction History");
    eraseText(0x35, 20);
    sendTextAscii(0x35, "Restart/Change User");
    generateDefaultQrpage();                                                         //generating default QR
    Serial.println("Default QR displayed");
    delay(100);
    displayNetwork(networkAvailable);
    Serial.println("Static QR  page displayed.");
  }
  wakeupFlag = false;                                                                // Resetting wakeup flag
  getMsgcnt();
  attachInterrupt(BUTTON_PIN, buttonPress, FALLING);                         // Interrupt for previous readings 
  attachInterrupt(36, increasePress, FALLING);                               // Interrupt for increase volume button
  attachInterrupt(39, decreasePress, FALLING);                               // Interrupt for decrease volume button
}

void loop() {
  if (isAmount == false) {
    if (finalKeypadAmount != "") {
      handleQRCode();                                                                 // handling the generated QR code

      /*if(countdownTime == 0){
         hmi.setPage(02);
         eraseText(TIME, 10);
        }*/
      if (hmi.getPage() != 19 && countdownTime < 59) {                               // If back button pressed
        countdownTime = 0;
        finalKeypadAmount = "";
        receiving_Amount();
        eraseText(TIME, 10);
        eraseText(0x41, 12);
        eraseText(0x67, 15);
        //dwinSerial.write(ResetAmt, 11);
      }
    }
    else {
      receiving_Amount();                                                             // Receiving amount from keypad
    }
  }

  else {
    if ((finalKeypadAmount.length()) < 10 ) {                                         // generating QR with amount
      Serial.print("QR generated for : ");
      Serial.println(finalKeypadAmount);
      dwinSerial.write(onDisplay, 7);
      setPage(19);
      sendTextAscii(0x67, currency + " " + finalKeypadAmount);
      generateAmountQRCode(finalKeypadAmount);
    }
    isAmount = false;
  }

  counter++;

  if (bleMode) {
    updateBLESerial();                                                                //Receiving amount from BLE to generate QR code
  }
  updateSerial();                                                                     //Receiving data from cellular

  /*********************************Network Searching*************************************************/
  /*if (!(networkAvailable) && (batperc > lowThreshold)) {
    if (!modem.waitForNetwork(1000L)) {
      //delay(10000);
      //return;
    }
    if (modem.isNetworkConnected()) {
      //audioPlayer(1003);
      networkAvailable = true;
      displayNetwork(true);
      configModule();
      Serial.println("Network connected");
    }
  }*/

  /******************************Volume Adjustment*****************************************************/
//  // Check if the increase volume button is pressed
//  if (digitalRead(increaseVol_PIN) == LOW) {                                              // Checking increase volume button action
//    increaseVolume();
//    delay(100);
//  }
//
//  // Check if the decrease volume button is pressed
//  if (digitalRead(decreaseVol_PIN) == LOW) {                                             // Checking decrease volume button action
//    decreaseVolume();
//    delay(100);
//  }

  if(increaseVol){
    increaseVolume();
    increaseVol = false;
  }
  if(decreaseVol){
    decreaseVolume();
    decreaseVol = false;
  }

  /****************************  Check the state of the previous button ************************************/
  if ((Button_flag != false))
  {
    Serial.print("message count is: "); 
    Serial.println(Msg_cnt);
    Serial.print("Button_cnt is :");
    Serial.println(Button_cnt);
    Button_flag = false;
    
    if(Msg_cnt>=1 && Msg_cnt <= 5) {
    readMsgs();                                                                     // reading previous transaction as per input 
    }                                                                        
    Button_cnt = 0;
    
  }

  if ((Button_flag != true) && (batperc > lowThreshold)) {
    if ((counter % 400) == 0) {                                                     // Checking network status
      networkStatus();
    }
  }

  /***************************** Battery monitoring ***************************************/
  if ((millis() - bat_cal) > 120000) {   
    detachInterrupt(36);
    detachInterrupt(39);// Battery calculation
    if (hmi.getPage() != 10 && countdownTime == 0 && hmi.getPage() != 03) {
      
      battery_measurement();
      displayBattery();
      bat_cal = millis();
      
    }
    attachInterrupt(36, increasePress, FALLING);
    attachInterrupt(39, decreasePress, FALLING);
  }

 /***************************** Battery charging status ************************************/
  if (digitalRead(21) == LOW && chargingOn == false) {
    chargingOn = true;
    chargingStatus(chargingOn);
    dwinSerial.write(simulateTouch, 14);
    Serial.println("Loop on");
  }
  else if (digitalRead(21) == HIGH && chargingOn == true) {
    chargingOn = false;
    chargingStatus(chargingOn);
    dwinSerial.write(simulateTouch, 14);
    Serial.println("Loop off");
  }

 /************************************* Battery monitoring as per percentage ******************************************/
  if (((checktp < counter) || (batperc < lowThreshold)) && (Button_flag != true) && (Serial2.available() <= 0)) {

    counter = 0;
    //battery_measurement();
    if (batperc < mediumThreshold)
    {
      checktp = 1000;
    }
    else if (batperc < fullThreshold)
    {
      checktp = 2000;
    }
    //Serial.print("ADC Value: ");
    //Serial.println(adcValue);
    Serial.print("Battery Percentage: ");
    Serial.print(batperc);
    Serial.println(" %");
    Serial.print("checktp: ");
    Serial.println(checktp);

    /*--------------------- // Determine the current battery status and print it ----------------------------------*/
    if (batperc < lowThreshold)
    {
      Serial.println("Battery is Low");
      lastBatteryStatus = "Battery is Low";
      setPage(07);                                                             //Setting low battery page
      battery_measurement();

      audioPlayer(1009);                                                       // Play low battery audio
      Serial.println("Playing low battery audio");
      displayBattery();
      delay(1000);

      setPage(18);                                                             // Setting default QR page
      generateDefaultQrpage();
      battery_measurement();

      Serial.println("Static QR  page displayed.");

      if (batperc < 15.00) {
        esp_sleep_enable_timer_wakeup((TIME_TO_SLEEP * 60) * uS_TO_S_FACTOR); // Wake up ESP32 after 5 minutes for checking battery status
        Serial.println("Low Battery, Entering sleep mode!!");
        setPage(11);                                                          //Setting shutting down page on display
        Serial.flush();
        delay(2000);
        dwinSerial.write(offDisplay, 7);
        esp_deep_sleep_start();
      }
    }
    else if (batperc >= fullThreshold)
    {
      if (lastBatteryStatus != "Battery is Full")
      {
        audioPlayer(1008);                                                    // Play full battery audio
        Serial.println("Playing full battery audio");
        Serial.println("Battery is Full");
        lastBatteryStatus = "Battery is Full";
      }
    }
    else
    {
      if (lastBatteryStatus != "")
      {
        Serial.println("Battery is in medium range");
        lastBatteryStatus = "";
      }
    }
  }




}


/************************ Receiving amount from BLE ********************************/
void updateBLESerial() {
  if (Parameter_flag) {
    String received ;
    received = String(Recieved);
    Serial.print("##BB received is : ");
    Serial.println(received);
    if (received.length() > 0) {                                                      // Verifying amount received from BLE
      Serial.println("updateBLESerial:1 ");
      const char* receivedCStr = received.c_str(); Serial.println("receivedCStr: "); Serial.println(receivedCStr);
      if ((strstr(receivedCStr , "Amount:"))) {
        Serial.println("updateBLESerial:2 ");
        int firstColn = received.indexOf(':');
        String get_amt = received.substring(firstColn + 1);
        Parameter_flag = false;

        amount = atof(get_amt.c_str());                                               // Convert the number buffer to an integer amount

        // memcpy(&ResetAmt[6], &amount, 2);                                          // Copy only two bytes for high and low
        countdownTime = 60;
        finalKeypadAmount = String(amount);
        // setPage(19);
        isAmount = true;
        sendTextAscii(0x41, "Through BLE");
        dwinSerial.write(simulateTouch, 14);
      }
    }
    memset(Recieved, 0, sizeof(Recieved));
  }
}
/****************************** updateBLESerial() function end *********************************************/

/************************** Receiving data from cellular ****************************************************/
void updateSerial() {
  int cmtstart = 0, cmtlast = 0, cmtmid = 0;                                                  //For multiple messages
  // Check if data is available to read from UART
  if (Serial2.available() > 0) {
    String receivedString = Serial2.readString();
    response = receivedString;
    Serial.println(response);

    cmtstart = response.indexOf("+CMT: ");
    cmtmid = response.indexOf("+CMT: ", cmtstart + 1);
    cmtlast = response.lastIndexOf("+CMT: ");

    const int length = response.length();                                                    // get the length of the text
    lower = (char*)malloc(length + 1);                                                       // allocate 'length' bytes + 1 (for null terminator) and cast to char*
    lower[length] = 0;                                                                       // set the last byte to a null terminator

    for (int i = 0; i < length; i++) {
      lower[i] = tolower(response[i]);
    }

    if ((strstr(lower, "upi")) || (strstr(lower, "ref"))) {                                 // Checking for UPI payments
      if ((strstr(lower, bankName.c_str()))) {
        if (cmtstart == cmtlast) {
          messageBuffer[index1] = response;
          Serial.print("Message stored at: "); Serial.println(index1);
          index1++;
        }
        else {
          messageBuffer[index1] = response;
          Serial.print("Message stored at: "); Serial.println(index1);
          index1++;

          while (cmtmid != cmtlast) {                                                        // Storing multiple message in buffer
            messageBuffer[index1] = response.substring(cmtmid);
            Serial.print("Message stored at: "); Serial.println(index1);
            index1++;
            cmtmid = response.indexOf("+cmt: ", cmtmid + 1);
          }
          messageBuffer[index1] = response.substring(cmtlast);
          Serial.print("Message stored at: "); Serial.println(index1);
          index1++;
        }
        messageBuffer[index1++] = "";
      }
    }

    if (messageBuffer[0] != "") {

      String msg = messageBuffer[0];                                                    // Processing messages stored in buffer

      int dateIndex = msg.indexOf(",\"") + 2;                                           // Find starting point of the date
      int timeIndex = msg.indexOf(",", dateIndex) + 1;                                  // Find starting point of the time

      date = msg.substring(dateIndex, dateIndex + 8);                                   // Extract date (YY/MM/DD)
      preTime = msg.substring(timeIndex, timeIndex + 8);                                // Extract time (HH:MM:SS)
      Serial.println(preTime + " on " + date);

      const int length1 = msg.length();                                                 // get the length of the text
      promsg = (char*)malloc(length1 + 1);                                              // allocate 'length' bytes + 1 (for null terminator) and cast to char*
      promsg[length1] = 0;                                                              // set the last byte to a null terminator

      for (int i = 0; i < length1; i++) {
        promsg[i] = tolower(msg[i]);
      }
      Serial.print("Whole Msg - ");
      Serial.println(promsg);

      Serial.println("\n");

      // Convert String to C-style stringString bankID_4=
      const char* bankIDCStr = bankID_4.c_str(); Serial.println("bankIDCStr: "); Serial.println(bankIDCStr);
      const char* bankNameCStr = bankName.c_str(); Serial.println("bankNameCStr: "); Serial.println(bankNameCStr);

      //final_amount = "";
      if ((strstr(promsg, bankNameCStr)))                                      //Check with bank
      {
        Serial.println(" BANK SMS ID IS VERIFIED");
        if ((strstr(promsg,  bankIDCStr)))                                     //Check with last 4 digit of bank account no with last 4 digit.
        {
          Serial.println(" BANK ACCOUNT IS VERIFIED");
          if ((strstr(promsg, "credited")) || (strstr(promsg, "debited")) || (strstr(promsg, "sent")) || (strstr(promsg, "received"))) //Check with credit/debit_keyword
          {
            Serial.println(" BANK AMOUNT CREDITED/DEBITED IS VERIFIED");
            if ((strstr(promsg, "rs ")) || (strstr(promsg, "rs.")) || (strstr(promsg, "inr ")) || (strstr(promsg, "rs:"))) //Check with currency_keyword
            {
              Serial.println(" BANK AMOUNT RS /RS./INR /RS:/ IS VERIFIED");
              Serial.print("Processing bank message: "); Serial.println(promsg);

              // Check for specific keywords in the lower string
              if (strstr(promsg, "rs "))                                        // If "rs " is found in lower
              {
                CheckWordInString_rs(promsg);                                   // Call the function to process the "rs " keyword
              }
              else if (strstr(promsg, "rs."))                                        // If "rs." is found in lower
              {
                CheckWordInString_rsDot(promsg);                                // Call the function to process the "rs." keyword
              }
              else if (strstr(promsg, "rs:"))                                        // If "rs:" is found in lower
              {
                CheckWordInString_rsCol(promsg);                                // Call the function to process the "rs:" keyword
              }
              else if (strstr(promsg, "inr "))                                       // If "inr " is found in lower
              {
                CheckWordInString_inrDot(promsg);                               // Call the function to process the "inr." keyword
              }

              saveMsgs();
              savetime();
              displaytransaction();
              dwinSerial.write(simulateTouch, 14);
              if ((countdownTime > 0) && (finalKeypadAmount != String(final_amount))) {     // Payment alert with audio
                Serial.println(finalKeypadAmount);
                Serial.print("final_amount=");
                Serial.println(final_amount);
                //delay(10);
                voice_commands(final_amount);
                //delay(10);
                Serial.println("Done with Voice commands. 1");
              }
              else {
                countdownTime = 0;
                setPage(05);                                                               //Setting received payment page
                dwinSerial.write(onDisplay, 7);
                sendTextAscii(CURRENT_PAY, currency + " " + String(final_amount));
                //delay(10);
                Serial.print("final_amount=");
                Serial.println(final_amount);
                voice_commands(final_amount);
                //delay(10);
                Serial.println("Done with Voice commands. 2");
                setPage(18);                                                               // Setting default QR page
                generateDefaultQrpage();
                Serial.println("Static QR  page displayed.");
              }
              if (messageBuffer[1] == "") {
                messageBuffer[0] = "";
                memset(messageBuffer, 0, sizeof(messageBuffer));
                index1 = 0;
              }
            }
          }
        }
      }
    }

    else if ((strstr(lower, "+cmti:  "))) {
      String result = (String)lower;
      int firstComma = result .indexOf("+cmti: "); Serial.println("firstComma"); Serial.println(firstComma);
      int secondComma = result .indexOf(','); Serial.println("secondComma"); Serial.println(secondComma);
      // Extract the csq from the received string
      String memory = result .substring(firstComma, secondComma);
      String strindex = result.substring(secondComma);
      Serial2.println("AT+CMGR=strindex");
    }

    else if ((strstr(lower, "+creg:")))                                                 //Check with "+CSQ"+CSQ: <rssi>,<ber>
    {
      if ((strstr(lower, " 0,1"))) {
        Serial.println("*************Network Connected*****************");
        if (!networkAvailable) {
          networkAvailable = true;
          displayNetwork(networkAvailable);
        }
      }
      else {
        Serial.println("*************Poor Connection*******************");
        if (networkAvailable) {
          networkAvailable = false;
          displayNetwork(networkAvailable);
        }
      }
    }

    else if ((strstr(lower, "+cpin:")))                                                        //Check with "+CPIN:READY"
    {
      if ((strstr(lower, "not")))
      {
        Serial.println("*****************SIM is not inserted ,Please check it. ************************");
        audioPlayer(1013);
      }
      else
      {
        Serial.println("*****************SIM is READY************************");
      }
    }


    for (int i = 0; i < BUFFER_SIZE - 1; i++) {                                              // Resetting buffer after processing message
      if (messageBuffer[i] == "") {
        index1 = i;
        break;
      }
      messageBuffer[i] = messageBuffer[i + 1];
      messageBuffer[i + 1] = "";
      if (index1 > 0) {
        index1--;
      }
    }


    // Clear variables for next iteration
    //response = "";
    // res = "";
    free(lower);                                                                           // freeing the memory of heap
    lower = NULL;
    promsg = "";
    msg = "";
  }
}
/****************************** updateSerial() function end *************************************************/

/**************************** void CheckWordInString_rs(char* str)  ****************************************/
void CheckWordInString_rs(char* str)
{
  int i = 0;

  // Find the position of the first occurrence of "rs"
  while (promsg[i] != 'r' || promsg[i + 1] != 's' || promsg[i + 2] != ' ') i++;

  String result = (String)promsg;                                                       // Convert the lower string to a String object
  result = result.substring(i + 3);                                                     // Get the substring after "rs"
  Serial.print("RESULT FROM SUBSTRING IS :");
  Serial.println(result);

  i = 0;
  // Find the position of the first space after "rs"
  while (result[i] != ' ') i++;

  // Extract the substring from the start to the first space (the amount)
  final_amount = result.substring(0, i);
  if (final_amount[final_amount.length() - 3] == '.') {
    Serial.print("Final Amount - ");
    Serial.println(final_amount);
  }
  else {
    final_amount += ".00";
    Serial.print("Final Amount - ");
    Serial.println(final_amount);
  }
}
/*************************************** CheckWordInString_rs(char* str) function end ***************************************/

/**************************** Finding "rs.": The functions search for the position of "rs" or "rs." in the lower string using a while loop. They increment i until the target substring is found. ************************************/
void CheckWordInString_rsDot(char* str)
{
  int i = 0;
  // Find the position of the first occurrence of "rs."
  while (promsg[i] != 'r' || promsg[i + 1] != 's' || promsg[i + 2] != '.') i++;

  String result = (String)promsg;                                             // Convert the lower string to a String object
  result = result.substring(i + 3);                                           // Get the substring after "rs."

  i = 0;
  // Find the position of the first space after "rs."
  while (result[i] != ' ') i++;

  // Extract the substring from the start to the first space (the amount)
  final_amount = result.substring(0, i);
  if (final_amount[final_amount.length() - 3] == '.') {
    Serial.print("Final Amount - ");
    Serial.println(final_amount);
  }
  else {
    final_amount += ".00";
    Serial.print("Final Amount - ");
    Serial.println(final_amount);
  }
}
/*************************************** CheckWordInString_rsDot(char* str) function end ***************************************/

/************************************** Finding "rs:": The functions search for the position of "rs:" ************************/
void CheckWordInString_rsCol(char* str)
{
  int i = 0;
  // Find the position of the first occurrence of "rs:"
  while (promsg[i] != 'r' || promsg[i + 1] != 's' || promsg[i + 2] != ':') i++;

  String result = (String)promsg;                                                     // Convert the lower string to a String object
  result = result.substring(i + 3);                                                   // Get the substring after "rs:"

  i = 0;
  // Find the position of the first space after "rs."
  while (result[i] != ' ') i++;

  // Extract the substring from the start to the first space (the amount)
  final_amount = result.substring(0, i);
  if (final_amount[final_amount.length() - 3] == '.') {
    Serial.print("Final Amount - ");
    Serial.println(final_amount);
  }
  else {
    final_amount += ".00";
    Serial.print("Final Amount - ");
    Serial.println(final_amount);
  }
}
/*********************************** CheckWordInString_rsCol(char* str) function end ******************************************/

/*********************************** Finding "inr.": The functions search for the position of "inr." **************************/
void CheckWordInString_inrDot(char* str) {
  Serial.println("Checking amount value");
  int i = 0;
  // Find the position of the first occurrence of "inr "
  while (promsg[i] != 'i' || promsg[i + 1] != 'n' || promsg[i + 2] != 'r' || promsg[i + 3] != ' ') i++;

  String result = (String)promsg;                                               // Convert the lower string to a String object
  result = result.substring(i + 4);                                             // Get the substring after "inr "

  i = 0;
  // Find the position of the first space after "rs."
  while (result[i] != ' ') i++;

  // Extract the substring from the start to the first space (the amount)
  final_amount = result.substring(0, i);
  if (final_amount[final_amount.length() - 3] == '.') {
    Serial.print("Final Amount - ");
    Serial.println(final_amount);
  }
  else {
    final_amount += ".00";
    Serial.print("Final Amount - ");
    Serial.println(final_amount);
  }
}
/**************************** CheckWordInString_inrDot(char* str) function end ************************************/

/**************************** Audio commands for Amount **************************************************************/
void voice_commands(String amount) {
  const char *float_amount = amount.c_str();                                      // Convert the amount from String to const char* for further processing
  int amount_int = amount.toInt();                                                // Convert the amount from String to integer
  String amt_conversion = (String)amount_int;                                     // Convert the integer amount back to String for length calculation
  // Get the length of the integer amount string
  int amount_len = amt_conversion.length();

  Serial.println(amount);

  // Additional code for voice command processing would go here

  // Only play audio if final_amount is set and audio is not already playing
  if (!final_amount.isEmpty() && !audioPlaying)
  {
    audioPlayer(1010);                                                              // Play intro audio
    // delay(3000);                                                                 // Delay for intro audio
  }

  // Save amount to SPIFFS
  final_amount = "";                                                                // Reset final_amount after speaking once
  //}

  if (amount_int <= 20)                                                             //if amount is less than and equal to 20.
  {
    audioPlayer(amount_int);
    Serial.println(amount_int);
  }

  if (amount_len == 2 && amount_int > 20)                                        // if amount is greater than 20 and length of string is 2.
  {
    int a[2];
    a[0] = amount_int / 10;
    a[1] = amount_int % 10;

    int value_1 = a[0] * 10;
    int value_2 = a[1];

    audioPlayer(value_1);

    Serial.println(value_1);

    if (value_2 != 0)
    {
      //  myDFPlayer.playMp3Folder(value_2);
      audioPlayer(value_2);
      Serial.println(value_2);
    }
  }

  if (amount_len == 3)                                                            //if length of amount is 3.
  {
    int a[3];
    a[0] = amount_int / 100;
    int unit = amount_int % 100;
    a[1] = unit / 10;
    a[2] = unit % 10;

    int value_1 = a[0];                                                           //final values to initiate voice command is placed in value_....
    int value_2 = a[1] * 10;
    int value_3 = a[2];

    audioPlayer(value_1);

    audioPlayer(100);

    if (unit <= 20 && value_2 != 0)                                               // unit stores the value placed at tens and ones place 120
    {
      audioPlayer(unit);
      Serial.println(unit);
    }

    else if (value_2 != 0 || value_3 != 0)                                        // if unit value is greater than 20
    {
      if (value_2 != 0)
      {
        audioPlayer(value_2);
        Serial.println(value_2);
      }

      if ( value_3 != 0)
      {
        audioPlayer(value_3);
        Serial.println(value_3);
      }
    }
  }//amount_len == 3 loop end here.

  if (amount_len == 4)                                                              // if amount is 4 digit number.
  {
    int a[4];
    a[0] = amount_int / 1000;
    int  unit = amount_int % 1000;
    a[1] = unit / 100;
    int unit_1 = amount_int % 1000;
    String unit_str = (String)unit_1;
    int unit_len = unit_str.length();

    int value_1 = a[0];
    int value_2 = a[1];

    audioPlayer(value_1);

    Serial.println(value_1);

    // myDFPlayer.playMp3Folder(1000);                                           //play specific mp3 in SD:/MP3/1000.mp3; File Name(0~65535)
    audioPlayer(1000);

    //value present at hundreds place.
    if (value_2 != 0)
    {
      audioPlayer(value_2);
      audioPlayer(100);
      Serial.println(value_2);
    }

    // condition satisfied when value placed at hundred is not zero..
    if (unit_len == 3 )
    {
      int unit_2 = unit_1 % 100;
      a[2] = unit_2 / 10;
      a[3] = unit_2 % 10;

      int value_3 = a[2] * 10;
      int value_4 = a[3];

      if (unit_2 <= 20)
      {
        audioPlayer(unit_2);
        Serial.println(unit_2);
      }

      else if (value_3 != 0)
      {
        audioPlayer(value_3);
        Serial.println(value_3);
      }

      if ( value_4 != 0 && unit_2 >= 20)
      {
        //    myDFPlayer.playMp3Folder(value_4);
        audioPlayer(value_4);
        Serial.println(value_4);
      }
    }
    
    if (unit_len == 2 || unit_len == 1)                                               // condition satisfied when value placed at hundred position is zero.
    {
      int unit_2 = unit_1 / 10;
      a[2] = unit_2;
      a[3] = unit_1 % 10;

      int value_3 = a[2] * 10;
      int value_4 = a[3];

      if (unit_1 <= 20)
      {
        audioPlayer(unit_1);
        Serial.println(unit_1);
      }

      else if (value_3 != 0) {
        audioPlayer(value_3);
        Serial.println(value_3);
      }

      if ( value_4 != 0 && unit_1 >= 21)
      {
        audioPlayer(value_4);
        Serial.println(value_4);
      }
    }
  }
  //amount_len == 4 loop end here

  if (amount_len == 5)
  {
    int a[5];
    a[0] = amount_int / 1000;
    int unit_1 = amount_int % 1000;
    String unit_str = (String)unit_1;
    int unit_len = unit_str.length();

    int value_1 = a[0];

    if (value_1 <= 20)                                                                //if amount is less than and equal to 20.
    {
      audioPlayer(value_1);
      audioPlayer(1000);
    }

    else if (value_1 > 20)                                                           // if amount is greater than 20 and length of string is 2.
    {
      int a[2];
      a[0] = value_1 / 10;
      a[1] = value_1 % 10;

      int value_1 = a[0] * 10;
      int value_2 = a[1];

      audioPlayer(value_1);

      Serial.println(value_1);

      if (value_2 != 0) {

        audioPlayer(value_2);

        Serial.println(value_2);
      }
      audioPlayer(1000);
    }

    if (unit_len == 3 )                                                                // condition satisfied when value placed at hundred is not zero..
    { 
      int a[3];
      a[0] = unit_1 / 100;
      int unit_2 = unit_1 % 100;
      a[1] = unit_2 / 10;
      a[2] = unit_2 % 10;

      //final values to initiate voice command is placed in value_....
      int value_1 = a[0];
      int value_2 = a[1] * 10;
      int value_3 = a[2];

      audioPlayer(value_1);

      // myDFPlayer.playMp3Folder(100);                                          //play specific mp3 in SD:/MP3/100.mp3; File Name(0~65535)
      audioPlayer(100);

      if (unit_2 <= 20 && value_2 != 0)                                          // unit stores the value placed at tens and ones place 120
      {
        audioPlayer(unit_2);
        Serial.println(unit_2);
      }

      else if (value_2 != 0 || value_3 != 0)                                     // if unit value is greater than 20
      {
        if (value_2 != 0)
        {
          audioPlayer(value_2);
          Serial.println(value_2);
        }

        if ( value_3 != 0)
        {
          audioPlayer(value_3);
          Serial.println(value_3);
        }
      }
    }
    // condition satisfied when value placed at hundred position is zero.
    if (unit_len == 2 || unit_len == 1)
    {
      int unit_2 = unit_1 / 10;
      a[2] = unit_2;
      a[3] = unit_1 % 10;

      int value_3 = a[2] * 10;
      int value_4 = a[3];

      if (unit_1 <= 20)
      {
        audioPlayer(unit_1);
        Serial.println(unit_1);
      }

      else if (value_3 != 0)
      {
        //  myDFPlayer.playMp3Folder(value_3);
        audioPlayer(value_3);
        Serial.println(value_3);
      }

      if ( value_4 != 0 && unit_1 >= 21)
      {
        //  myDFPlayer.playMp3Folder(value_4);
        audioPlayer(value_4);
        Serial.println(value_4);
      }
    }
  }

  //loop to extract decimal value from amount...
  if (strstr(float_amount, "."))
  {
    int i = 0;
    while (amount[i] != '.')i++;

    String sliced_amount = amount.substring(i + 1);
    int decimal_value = sliced_amount.toInt();
    if (decimal_value != 0)
    {
      // voice command for (and) is stored at 65000..
      audioPlayer(1011);
      if (decimal_value <= 20)
      {
        // myDFPlayer.playMp3Folder(decimal_value);
        audioPlayer(decimal_value);
      }
      if (decimal_value > 20)
      {
        int a[2];
        a[0] = decimal_value / 10;
        a[1] = decimal_value % 10;

        int value_1 = a[0] * 10;
        int value_2 = a[1];

        //  myDFPlayer.playMp3Folder(value_1);
        audioPlayer(value_1);
        audioPlayer(value_2);
      }
      // voice command for paise is stored at 64000..
      audioPlayer(1012);
    }
  }
}
/*************************** voice_commands(String amount) function end **********************************/

/**************************** void audioPlayer(int val)***************************************************/
void audioPlayer(int val)
{
  if (!audioPlaying && !audio.isRunning())
  {
    int rcv_value = val;
    switch (rcv_value)
    {
      case 1: audio.connecttoFS(SD, "/ModAudio/0001.mp3");                                    // Adjusted file path
        audioPlaying = true;
        break;
      case 2: audio.connecttoFS(SD, "/ModAudio/0002.mp3");                                    // Adjusted file path
        audioPlaying = true;
        break;
      case 3: audio.connecttoFS(SD, "/ModAudio/0003.mp3");                                    // Adjusted file path
        audioPlaying = true;
        break;
      case 4: audio.connecttoFS(SD, "/ModAudio/0004.mp3");                                    // Adjusted file path
        audioPlaying = true;
        break;
      case 5: audio.connecttoFS(SD, "/ModAudio/0005.mp3");                                    // Adjusted file path
        audioPlaying = true;
        break;
      case 6: audio.connecttoFS(SD, "/ModAudio/0006.mp3");                                    // Adjusted file path
        audioPlaying = true;
        break;
      case 7: audio.connecttoFS(SD, "/ModAudio/0007.mp3");                                    // Adjusted file path
        audioPlaying = true;
        break;
      case 8: audio.connecttoFS(SD, "/ModAudio/0008.mp3");                                    // Adjusted file path
        audioPlaying = true;
        break;
      case 9: audio.connecttoFS(SD, "/ModAudio/0009.mp3");                                   // Adjusted file path
        audioPlaying = true;
        break;
      case 10: audio.connecttoFS(SD, "/ModAudio/0010.mp3");                                  // Adjusted file path
        audioPlaying = true;
        break;
      case 11: audio.connecttoFS(SD, "/ModAudio/0011.mp3");                                  // Adjusted file path
        audioPlaying = true;
        break;
      case 12: audio.connecttoFS(SD, "/ModAudio/0012.mp3");                                  // Adjusted file path
        audioPlaying = true;
        break;
      case 13: audio.connecttoFS(SD, "/ModAudio/0013.mp3");                                  // Adjusted file path
        audioPlaying = true;
        break;
      case 14: audio.connecttoFS(SD, "/ModAudio/0014.mp3");                                  // Adjusted file path
        audioPlaying = true;
        break;
      case 15: audio.connecttoFS(SD, "/ModAudio/0015.mp3");                                  // Adjusted file path
        audioPlaying = true;
        break;
      case 16: audio.connecttoFS(SD, "/ModAudio/0016.mp3");                                  // Adjusted file path
        audioPlaying = true;
        break;
      case 17: audio.connecttoFS(SD, "/ModAudio/0017.mp3");                                  // Adjusted file path
        audioPlaying = true;
        break;
      case 18: audio.connecttoFS(SD, "/ModAudio/0018.mp3");                                  // Adjusted file path
        audioPlaying = true;
        break;
      case 19: audio.connecttoFS(SD, "/ModAudio/0019.mp3");                                 // Adjusted file path
        audioPlaying = true;
        break;
      case 20: audio.connecttoFS(SD, "/ModAudio/0020.mp3");                                 // Adjusted file path
        audioPlaying = true;
        break;
      case 30: audio.connecttoFS(SD, "/ModAudio/0030.mp3");                                 // Adjusted file path
        audioPlaying = true;
        break;
      case 40: audio.connecttoFS(SD, "/ModAudio/0040.mp3");                                 // Adjusted file path
        audioPlaying = true;
        break;
      case 50: audio.connecttoFS(SD, "/ModAudio/0050.mp3");                                 // Adjusted file path
        audioPlaying = true;
        break;
      case 60: audio.connecttoFS(SD, "/ModAudio/0060.mp3");                                // Adjusted file path
        audioPlaying = true;
        break;
      case 70: audio.connecttoFS(SD, "/ModAudio/0070.mp3");                                // Adjusted file path
        audioPlaying = true;
        break;
      case 80: audio.connecttoFS(SD, "/ModAudio/0080.mp3");                                // Adjusted file path
        audioPlaying = true;
        break;
      case 90: audio.connecttoFS(SD, "/ModAudio/0090.mp3");                                // Adjusted file path
        audioPlaying = true;
        break;
      case 100: audio.connecttoFS(SD, "/ModAudio/0100.mp3");                               // Adjusted file path
        audioPlaying = true;
        break;
      case 1000: audio.connecttoFS(SD, "/ModAudio/1000.mp3");                              // Adjusted file path
        audioPlaying = true;
        break;
      case 1001: audio.connecttoFS(SD, "/ModAudio/1_Poweron.mp3");                         // Adjusted file path
        audioPlaying = true;
        break;
      case 1002: audio.connecttoFS(SD, "/ModAudio/2_Welcome.mp3");                         // Adjusted file path
        audioPlaying = true;
        break;
      case 1003: audio.connecttoFS(SD, "/ModAudio/3_Netconn.mp3");                         // Adjusted file path
        audioPlaying = true;
        break;
      case 1004: audio.connecttoFS(SD, "/ModAudio/4_Netdiscon.mp3");                       // Adjusted file path
        audioPlaying = true;
        break;
      case 1005: audio.connecttoFS(SD, "/ModAudio/5_BLEconn.mp3");                         // Adjusted file path
        audioPlaying = true;
        break;
      case 1006: audio.connecttoFS(SD, "/ModAudio/6_BLEconfig.mp3");                       // Adjusted file path
        audioPlaying = true;
        break;
      case 1007: audio.connecttoFS(SD, "/ModAudio/7_BLEdiscon.mp3");                       // Adjusted file path
        audioPlaying = true;
        break;
      case 1008: audio.connecttoFS(SD, "/ModAudio/8_Batfull.mp3");                         // Adjusted file path 
        audioPlaying = true;
        break;
      case 1009: audio.connecttoFS(SD, "/ModAudio/9_Batlow.mp3");                          // Adjusted file pathN
        audioPlaying = true;
        break;
      case 1010: audio.connecttoFS(SD, "/ModAudio/10_Intro.mp3");                          // Welcome audio
        audioPlaying = true;
        break;
      case 1011: audio.connecttoFS(SD, "/ModAudio/11_AND.mp3");                            // Adjusted file path
        audioPlaying = true;
        break;
      case 1012: audio.connecttoFS(SD, "/ModAudio/12_Paise.mp3");                          // Adjusted file path
        audioPlaying = true;
        break;
      case 1013: audio.connecttoFS(SD, "/ModAudio/13_SIMloss.mp3");                        // Adjusted file path
        audioPlaying = true;
        break;
      case 1014: audio.connecttoFS(SD, "/ModAudio/14_UserConfig.mp3");                     // Adjusted file path
        audioPlaying = true;
        break;
      case 1015: audio.connecttoFS(SD, "/Vishwaguru/welcome.mp3");                         // Adjusted file path
        audioPlaying = true;
        break;
      default:
        break;
    }
  }
  // Check if audio is done playing
  if (audioPlaying)
  {
    while (audioPlaying && audio.isRunning())
    {
      audio.loop();
    }
    audioPlaying = false;
  }
}
/****************************** audioPlayer(int val) fuction end **************************************************************/

/****************************** File Opening: The function attempts to open a file named "amount.txt" in write mode using SPIFFS.open("/amount.txt", FILE_WRITE).************************************/
void writeToSPIFFS(String amount)
{
  // Open the file in write mode
  File file = SPIFFS.open("/amount.txt", FILE_WRITE);
  if (!file)                                                                 // Check if the file was opened successfully
  {
    // Print an error message if the file could not be opened
    Serial.println("Failed to open file for writing");
    return;                                                                 // Exit the function if file opening failed
  }
  
  file.print(amount);                                                       // Write the amount to the file
  file.close();                                                             // Close the file to save changes

  Serial.println("Amount written to SPIFFS successfully");                 // Print a success message
}
/************************************* writeToSPIFFS(String amount) function end *******************************************/

/****************************File Opening: The function attempts to open a file named "amount.txt" in read mode using SPIFFS.open("/amount.txt", FILE_READ).************************************/
String readFromSPIFFS()
{
  File file = SPIFFS.open("/amount.txt", FILE_READ);                                 // Open the file in read mode

  if (!file)                                                                        // Check if the file was opened successfully
  {
    // Print an error message if the file could not be opened
    Serial.println("Failed to open file for reading");
    return "";                                                                       // Return an empty string if file opening failed
  }
  
  String amount = file.readString();                                                // Read the entire content of the file as a string                         

  file.close();                                                                     // Close the file after reading

  return amount;                                                                    // Return the read amount
}
/*************************** readFromSPIFFS() function end ******************************************************************/

/****************************The function calculates and prints the size of a specified file in the SPIFFS file system.  ************************************/
void file_size(fs::FS &fs, const char *path)
{
  Serial.printf("Reading file: %s\r\n", path);                                       // Print the file path being read
  File file = fs.open(path);                                                         // Open the file at the specified path

  if (!file)                                                                        // Check if the file was opened successfully
  {
    Serial.println("Failed to open file for reading");
    return;
  }

  Serial.print("  FILE: ");                                                         // Print the file name and its size
  Serial.print(file.name());
  Serial.print("\tSIZE: ");
  Serial.println(file.size());

  fs_size = file.size();                                                           // Store the file size in a global variable fs_size

  Serial.println(fs_size);                                                         // Print the file size

  file.close();                                                                    // Close the file
}
/****************************** file_size(fs::FS &fs, const char *path) function end ***************************************/

/****************************The function calculates and prints the size of a specified file in the SPIFFS file system.  ************************************/
void listDir(fs::FS &fs, const char *dirname, uint8_t levels)                    
{
  Serial.printf("Listing directory: %s\r\n", dirname);                           // list of files in directory

  File root = fs.open(dirname);                                                  // Open the directory
  if (!root)
  {
    Serial.println("- failed to open directory");                                // Print an error message if the directory could not be opened
    return;
  }
  if (!root.isDirectory())
  {
    Serial.println(" - not a directory");                                       // Print an error message if the path is not a directory
    return;
  }

  File file = root.openNextFile();                                             // Open the first file in the directory
  while (file)
  {
    if (file.isDirectory())
    {
      Serial.print("  DIR : ");                                               // If the file is a directory, print its name
      Serial.println(file.name());
      if (levels)
      {
        listDir(fs, file.name(), levels - 1);                                 // If levels is greater than 0, list the contents of the subdirectory
      }
    } else {
      Serial.print("  FILE: ");                                              // If the file is not a directory, print its name and size
      Serial.print(file.name());
      Serial.print("\tSIZE: ");
      Serial.println(file.size());
    }
    file = root.openNextFile();                                               // Open the next file in the directory
  }
}
/****************************** listDir(fs::FS &fs, const char *dirname, uint8_t levels) function end *************************/

/************************************ Writes a message to a specified file. ************************************************/
// Function to write a message to a file
void writeFile(fs::FS &fs, const char *path, const char *message)
{
  Serial.printf("Writing file: %s\r\n", path);                               // Print the file path being written to

  File file = fs.open(path, FILE_WRITE);                                     // Open the file in write mode
  if (!file)
  {
    Serial.println("- failed to open file for writing");                     // Print an error message if the file could not be opened
    return;
  }

  if (file.print(message))                                                  // Write the message to the file
  {
    Serial.println("- file written");                                       // Print a success message if the write operation was successful
  } else 
  {
    Serial.println("- write failed");                                       // Print an error message if the write operation failed
  }

  file.close();                                                            // Close the file to save changes (this step is implicit in the Arduino API)
}
/********************************** writeFile(fs::FS &fs, const char *path, const char *message) function end ******************/

/****************************Reads the contents of a specified file and prints it to the serial monitor.  ************************************/
// Function to read a file and print its contents
void readFile(fs::FS &fs, const char *path)
{
  Serial.printf("Reading file: %s\r\n", path);                             // Print the file path being read

  File file = fs.open(path);                                               // Open the file in read mode
  if (!file || file.isDirectory())
  {
    Serial.println("- failed to open file for reading");                   // Print an error message if the file could not be opened or is a directory
    return;
  }

  String String_receive = "";                                          
  Serial.println("- read from file:");
  if (file.available())
  {
    String_receive = file.readString();                                   // Read the content of the file into a string
  }

  Serial.print("String_receive = ");                                      // Print the read content
  Serial.println(String_receive);

  file.close();                                                           // Close the file
}
/*********************************** readFile(fs::FS &fs, const char *path) function end **************************************/

/****************************The function attempts to delete the file at the specified path using fs.remove(path). ************************************/
// Function to delete a file
void deleteFile(fs::FS &fs, const char *path)
{
  Serial.printf("Deleting file: %s\r\n", path);                             // Print the file path being deleted

  if (fs.remove(path))                                                      // Delete the file
  {
    // Print a success message if the file was deleted successfully
    Serial.println("- file deleted");
  }
  else
  {
    // Print an error message if the file deletion failed
    Serial.println("- delete failed");
  }
}
/********************************* deleteFile(fs::FS &fs, const char *path) function end **************************************/

/****************************The function ensures that the input voltage is within the defined range . ************************************/
float mapVoltageToPercentage(float voltage)
{
  // Clamp voltage to the range of minBatteryVoltage and maxBatteryVoltage
  // Ensure voltage does not go below the minimum battery voltage
  if (voltage < minBatteryVoltage)
    voltage = minBatteryVoltage;

  // Ensure voltage does not exceed the maximum battery voltage
  if (voltage > maxBatteryVoltage)
    voltage = maxBatteryVoltage;

  // Calculate the battery percentage based on clamped voltage
  // The percentage is calculated as the ratio of the current voltage
  // within the range of minBatteryVoltage to maxBatteryVoltage
  float percentage = (voltage - minBatteryVoltage) / (maxBatteryVoltage - minBatteryVoltage) * 100.0;
  // Return the calculated percentage
  return percentage;
}
/********************************* mapVoltageToPercentage(float voltage) function end *****************************************/

/****************************This function processes incoming Bluetooth data, parses it based on a predefined format, and provides feedback for debugging************************************/
void handleBluetoothInput()
{
  Serial.println("\n handleBluetoothInput() ");
  String received = SerialBT.readStringUntil('\n');                               // Read a line of input from the Bluetooth Serial connection until a newline character is encountered

  Serial.println("Received: " + received);                                        // Print the received input for debugging purposes

  int firstComma = received.indexOf(',');                                         // Find the positions of the first and second commas in the received string
  int secondComma = received.indexOf(',', firstComma + 1);

  if (firstComma > 0 && secondComma > firstComma)                                 // Check if both commas were found and their positions are valid
  {
    upiID = received.substring(0, firstComma);                                    // Extract the UPI ID, user name, and currency from the received string
    userName = received.substring(firstComma + 1, secondComma);
    currency = received.substring(secondComma + 1);

    Serial.println("UPI ID: " + upiID + ", Name: " + userName + ", Currency: " + currency);
  }
}
/**************************** handleBluetoothInput() function end ********************************************************/

/******************* Getting account details of user *********************************************************************/
void getAcc_details(void) {
  String received ;
  received = String(Recieved);
  Serial.print("## received is : ");
  Serial.println(received);
  if (received.length() > 0)
  {
    int firstComma = received.indexOf(',');                                        // Find the positions of the first and second commas in the received string

    if (firstComma > 0)                                                            // Check if both commas were found and their positions are valid
    {
      bankName = received.substring(0, firstComma);                                // Extract the bank name andacc num from the received string
      bankName.toLowerCase();
      bankID = received.substring(firstComma + 1);
      bankID_4 =  bankID.substring( bankID.length() - 4);
      Serial.println("bankName: " + bankName + ", bankID: " + bankID + ", bankID_4 : " + bankID_4 );
    }
  }
  memset(Recieved, 0, sizeof(Recieved));                                            // Resetting buffer
}
/************************************ getAcc_details(void) function end ********************************************************/

/************************************* Getting UPI details of user ************************************************************/
void getUpi_details(void) {
  String received ;
  received = String(Recieved);
  Serial.println("## received is : " + received);
  if (received.length() > 0)
  {
    int firstComma = received.indexOf(',');                                         // Find the positions of the first and second commas in the received string
    int secondComma = received.indexOf(',', firstComma + 1);

    if (firstComma > 0 && secondComma > firstComma)                                 // Check if both commas were found and their positions are valid
    {
      upiID = received.substring(0, firstComma);                                    // Extract the UPI ID, user name, and currency from the received string
      userName = received.substring(firstComma + 1, secondComma);
      currency = received.substring(secondComma + 1);
      Serial.println("UPI ID: " + upiID + ", Name: " + userName + ", Currency: " + currency);
    }
  }
  memset(Recieved, 0, sizeof(Recieved));                                            // Resetting buffer
}
/************************************* getUpi_details(void) function end ****************************************************/

/************************************* Setting APN details ******************************************************************/
void getApn_details(void)
{
  String received ;
  received = String(Recieved);
  Serial.println("## received is : " + received);
  if (received.length() > 0)
  {
    apnname = received.substring(0);
  }
  memset(Recieved, 0, sizeof(Recieved));                                          // Resetting buffer
}
/****************************************** getApn_details(void) function end **********************************************/

/****************************************** System configuration ***********************************************************/
void getConfig_details(void) {
  String received ;
  received = String(Recieved);
  Serial.println("## received is : " + received);
  if (received.length() > 0)
  {
    deviceConfig = received.substring(0);
  }
  memset(Recieved, 0, sizeof(Recieved));                                         // Resetting buffer
}
/******************************************* getConfig_details(void) function end ******************************************/

/******************************************* User authentication ***********************************************************/
void passwordVerification(void) {
  String received ;
  received = String(Recieved);
  Serial.println("## received is : " + received);
  if (received.length() > 0)
  {
    String get = received.substring(0);
    if (get == PASSWORD)
    {
      String response1 = "\n Password Verified Succeessfully";
      Serial.println("## Sent data  is : " + response1);
      pCharacteristic->setValue(response1.c_str());
      pCharacteristic->notify();
      Parameter_flag = false;
      Password_flag = true;
    }
    else
    {
      String response1 = "\n U have eneterd wrong password.Please enter correct password";
      Serial.println("## Sent data  is : " + response1);
      pCharacteristic->setValue(response1.c_str());
      pCharacteristic->notify();
      Parameter_flag = false;
    }
  }
  memset(Recieved, 0, sizeof(Recieved));                                             // Resetting buffer
}
/************************************ passwordVerification(void) function end ************************************************/

/************************************ Checking network connection ************************************************************/
void networkStatus(void)
{
  Serial2.println("AT+CREG?");
  Serial.println("Get Network Status");
}
/************************************ networkStatus(void) function end ******************************************************/

/************************************* Writing UPI details to file **********************************************************/
void writeUpidetails() {
  File file1 = SPIFFS.open("/Upistring1.txt", FILE_WRITE);
  if (!file1) {
    Serial.println("Failed to open file 1 for writing");
    return;
  }
  file1.println(bankName);
  file1.close();

  File file2 = SPIFFS.open("/Upistring2.txt", FILE_WRITE);
  if (!file2) {
    Serial.println("Failed to open file 2 for writing");
    return;
  }
  file2.println(bankID);
  file2.close();

  File file3 = SPIFFS.open("/Upistring3.txt", FILE_WRITE);
  if (!file3) {
    Serial.println("Failed to open file 3 for writing");
    return;
  }
  file3.println(upiID);
  file3.close();
  File file4 = SPIFFS.open("/Upistring4.txt", FILE_WRITE);
  if (!file4) {
    Serial.println("Failed to open file 4 for writing");
    return;
  }
  file4.println(userName);
  file4.close();

  File file5 = SPIFFS.open("/Upistring5.txt", FILE_WRITE);
  if (!file5) {
    Serial.println("Failed to open file 5 for writing");
    return;
  }
  file5.println(currency);
  file5.close();

  File file6 = SPIFFS.open("/Upistring6.txt", FILE_WRITE);
  if (!file6) {
    Serial.println("Failed to open file 6 for writing");
    return;
  }
  file6.println(apnname);
  file6.close();

  // Now you can use these strings as needed
  Serial.println("WRITE UPI DETAILS TO SSPIFFS");
}
/********************************** writeUpidetails() function end ***********************************************************/

/********************************** Reading UPI details from file ************************************************************/
void readUpidetails() {
  File file1 = SPIFFS.open("/Upistring1.txt", FILE_READ);
  if (!file1) {
    Serial.println("Failed to open file 1 for reading");
    return;
  }
  String input1 = file1.readStringUntil('\0');
  file1.close();

  File file2 = SPIFFS.open("/Upistring2.txt", FILE_READ);
  if (!file2) {
    Serial.println("Failed to open file 2 for reading");
    return;
  }

  String input2 = file2.readStringUntil('\0');
  file2.close();

  File file3 = SPIFFS.open("/Upistring3.txt", FILE_READ);
  if (!file3) {
    Serial.println("Failed to open file 3 for reading");
    return;
  }
  String input3 = file3.readStringUntil('\0');
  file3.close();

  File file4 = SPIFFS.open("/Upistring4.txt", FILE_READ);
  if (!file4) {
    Serial.println("Failed to open file 4 for reading");
    return;
  }
  String input4 = file4.readStringUntil('\0');
  file4.close();

  File file5 = SPIFFS.open("/Upistring5.txt", FILE_READ);
  if (!file5) {
    Serial.println("Failed to open file 5 for reading");
    return;
  }
  String input5 = file5.readStringUntil('\0');
  file5.close();

  File file6 = SPIFFS.open("/Upistring6.txt", FILE_READ);
  if (!file6) {
    Serial.println("Failed to open file 6 for reading");
    return;
  }
  String input6 = file6.readStringUntil('\0');
  file6.close();

  // Now you can use these strings as needed
  Serial.println("READ UPI DETAILS FROM SSPIFFS");

  bankName =  input1.substring(0, input1.length() - 2);
  bankID =  input2.substring(0, input2.length() - 2);
  bankID_4 =  bankID.substring(bankID.length() - 4);
  upiID =  input3.substring(0, input3.length() - 2);
  userName =  input4.substring(0, input4.length() - 2);
  currency =  input5.substring(0, input5.length() - 2);
  apnname =  input6.substring(0, input6.length() - 2);
}
/************************************ readUpidetails() function end ***********************************************************/

/************************************** Calculating battery percentage ********************************************************/
void battery_measurement()
{
  // Read the ADC value from the battery pin
  adc_power_acquire();
  ADCvalue = readStableADC(100);
  adc_power_release();
  //  Serial.print("ADC Value: ");
  //  Serial.println(ADCvalue);

  /*************  // Convert ADC value to voltage ****************/
  //Serial.println("Converting ADC value to voltage...");
  batvoltage = ((ADCvalue / float(adcMaxValue)) * referenceVoltage) + 0.2; // intentionally added 0.2v to compensate adc error
  Serial.print("Battery Voltage: ");
  Serial.print(batvoltage);
  Serial.println(" V");

  /************ // Calculate the battery percentage *************/
  //Serial.println("Calculating battery percentage...");
  batperc = mapVoltageToPercentage(batvoltage);
  Serial.print("Battery Percentage: ");
  Serial.print(batperc);
  Serial.println(" %");
}
/********************************** battery_measurement() function end ********************************************************/

/********************************** averaging adc *****************************************************************************/
int readStableADC(int samples) {
  long sum = 0;
  for (int i = 0; i < samples; i++) {
    sum += analogRead(batteryPin);                                                  // Reading adc value
    delay(2);
  }
  return sum / samples;
}
/*********************************** readStableADC(int samples) function end **************************************************/

/*********************************** Saving messages for transation **********************************************************/
void saveMsgscnt()
{
  pref.putInt("Msgcnt", Msg_cnt);
}
/*********************************** saveMsgscnt() function end **************************************************************/

/*********************************** Getting message of specific transaction ************************************************/
void getMsgcnt()
{
  int getValue = 0;
  Msg_cnt = pref.getInt("Msgcnt", getValue);
  //Serial.println("GET VALUE OF Msg_cnt: "); Serial.println(Msg_cnt);
}
/********************************** getMsgcnt() function end ****************************************************************/

/********************************** Saving messages for transaction history *************************************************/
void saveMsgs()
{
  Msg_cnt++;
  Serial.println("Msg_cnt: "); Serial.println(Msg_cnt);

  if (Msg_cnt == 6)
  {
    Msg_cnt = 1;
  }

  saveMsgscnt();
  if (Msg_cnt == 1)
  {
    pref.putString("str1", final_amount);
  }
  else if (Msg_cnt == 2)
  {
    pref.putString("str2", final_amount);
  }
  else if (Msg_cnt == 3)
  {
    pref.putString("str3", final_amount);
  }
  else if (Msg_cnt == 4)
  {
    pref.putString("str4", final_amount);
  }
  else if (Msg_cnt == 5)
  {
    pref.putString("str5", final_amount);
  }
}
/********************************* saveMsgs() function end *******************************************************************/

/********************************* Reading messages for accessing transaction ***********************************************/
void readMsgs() {
  Serial.println("Reading message");
  String storedAmount = "";
  String str = "";
  if (Msg_cnt == 5)                                                                   // If message count is 5
  {
    if (Button_cnt == 1)
    {
      storedAmount = pref.getString("str5", str);
    }
    else if (Button_cnt == 2)
    {
      storedAmount = pref.getString("str4", str);
    }
    else if (Button_cnt == 3)
    {
      storedAmount = pref.getString("str3", str);
    }
    else if (Button_cnt == 4)
    {
      storedAmount = pref.getString("str2", str);
    }
    else if (Button_cnt == 5)
    {
      storedAmount = pref.getString("str1", str);
    }
  }
  else if (Msg_cnt == 4)                                                                // If message count is 4
  {
    if (Button_cnt == 1)
    {
      storedAmount = pref.getString("str4", str);
    }
    else if (Button_cnt == 2)
    {
      storedAmount = pref.getString("str3", str);
    }
    else if (Button_cnt == 3)
    {
      storedAmount = pref.getString("str2", str);
    }
    else if (Button_cnt == 4)
    {
      storedAmount = pref.getString("str1", str);
    }
    else if (Button_cnt == 5)
    {
      storedAmount = pref.getString("str5", str);
    }
  }
  else if (Msg_cnt == 3)                                                                  // If message count is 3
  {
    if (Button_cnt == 1)
    {
      storedAmount = pref.getString("str3", str);
    }
    else if (Button_cnt == 2)
    {
      storedAmount = pref.getString("str2", str);
    }
    else if (Button_cnt == 3)
    {
      storedAmount = pref.getString("str1", str);
    }
    else if (Button_cnt == 4)
    {
      storedAmount = pref.getString("str5", str);
    }
    else if (Button_cnt == 5)
    {
      storedAmount = pref.getString("str4", str);
    }
  }
  else if (Msg_cnt == 2)                                                                  // If message count is 2
  {
    if (Button_cnt == 1)
    {
      storedAmount = pref.getString("str2", str);
    }
    else if (Button_cnt == 2)
    {
      storedAmount = pref.getString("str1", str);
    }
    else if (Button_cnt == 3)
    {
      storedAmount = pref.getString("str5", str);
    }
    else if (Button_cnt == 4)
    {
      storedAmount = pref.getString("str4", str);
    }
    else if (Button_cnt == 5)
    {
      storedAmount = pref.getString("str3", str);
    }
  }
  else if (Msg_cnt == 1)                                                                   // If message count is 1
  {
    if (Button_cnt == 1)
    {
      storedAmount = pref.getString("str1", str);
    }
    else if (Button_cnt == 2)
    {
      storedAmount = pref.getString("str5", str);
    }
    else if (Button_cnt == 3)
    {
      storedAmount = pref.getString("str4", str);
    }
    else if (Button_cnt == 4)
    {
      storedAmount = pref.getString("str3", str);
    }
    else if (Button_cnt == 5)
    {
      storedAmount = pref.getString("str2", str);
    }
  }

  Serial.print("Stored Amount22: ");
  Serial.println(storedAmount);
  if (Button_cnt < 6)
  {
    Serial.println("Displaying previous amount page");
    setPage(06); //Previous received amount page
    sendTextAscii(PRE_PAY, currency + " " + storedAmount);

    audioPlayer(1010); // Play intro audio
    delay(10);
    voice_commands(storedAmount);
    delay(10);
    Serial.println("Executed voice commands");

    setPage(18);
    generateDefaultQrpage();
    Serial.println("Static QR  page displayed.");
  }
}
/********************************* readMsgs()function end *********************************************************************/

/********************************* Handling generated QR code with timer ******************************************************/
void handleQRCode()
{
  unsigned long currentMillis = millis();

  //ADD FUNCTION FOR QR WITH TIMER
  if (currentMillis - previousMillis >= interval)
  {
    previousMillis = currentMillis;
    if (countdownTime > 0) {                                                               // implementing timer for QR code
      countdownTime--;
      char time1[50] = {0};
      sprintf(time1, "%02d:%02d", countdownTime / 60, countdownTime % 60);                 // Display amount starting from left
      String time2 = String(time1);

      Serial.println("");
      //sendText(TIME, arr3);                                                             // updating timer on display
      sendTextAscii(TIME, time2);                                                         // updating timer on display
      dwinSerial.write(simulateTouch, 14);
    }
    else {
      Serial.println("Timer completed");
      Serial.println("Back to default page");
      //dwinSerial.write(ResetAmt, 11);
      finalKeypadAmount = "";               
      eraseText(TIME, 10);                                                                // erasing the time and amount details on display
      eraseText(0x41, 12);
      eraseText(0x67, 15);
      setPage(18);
      Serial.println("Static QR  page displayed.");
    }
  }
}
/********************************** handleQRCode() function end ***************************************************************/

/********************************** Receiving amount from keypad *************************************************************/
void receiving_Amount() {
  String amountValue = "";
  bool validInput = true;
  // Check if data is available on DWIN UART
  if (dwinSerial.available()) {
    uint8_t buffer[100];

    size_t len = dwinSerial.readBytes(buffer, 100);
    dwinSerial.write(ResetAmt, 11);                                                    // resetting amount to 0 on display

                                                                                       // Check for frame header 5A A5 and validate frame length
    if (len >= 11 && buffer[0] == 0x5A && buffer[1] == 0xA5) {
                                                                                        // Extract the integer and fractional parts from data
      uint32_t rawData = (buffer[7] << 24) | (buffer[8] << 16) | (buffer[9] << 8) | buffer[10];
      uint32_t integerPart = rawData / 100;
      uint32_t fractionalPart = rawData % 100;

                                                                                          // Validate input: Should be numeric and have no more than two decimal places
      if (fractionalPart < 10) {
        amountValue = String(integerPart) + ".0" + String(fractionalPart);
      } else {
        amountValue = String(integerPart) + "." + String(fractionalPart);
      }
      int length1 = amountValue.length();

      // Check if amount is a valid number (only digits and a decimal point)
      //        if (amountValue.indexOf('.') != -1) {
      //          validInput = true;
      //        } else {
      //          validInput = false;
      //        }
      //
      //        // If valid, store the value
      //        if (validInput) {
      //          finalKeypadAmount = amountValue;
      //          isAmount = true;                                                             // Mark amount as received

      //if (hmi.getPage() == 10) {
      if (length1 < 10) {
        Serial.print("Received Value: ");
        Serial.println(amountValue);

        /**********Direct switching page without considering generate button action**************************/

        finalKeypadAmount = amountValue;
        isAmount = true;
        // setPage(19);
        //        sendTextAscii(0x67, currency + " " + finalKeypadAmount);
        countdownTime = 60;
        //delay(200);
      }

      /************After Pressing generate button*****************************/

      /* if (hmi.getPage() == 19) {
         countdownTime = 60;
         finalKeypadAmount = amountValue;
         isAmount = true;
         //setPage(19);
         sendTextAscii(0x67, currency + " " + finalKeypadAmount);
         //delay(1000);
         Serial.print("countdown: ");
         Serial.println(countdownTime);
         if (hmi.getPage() != 19) {
           countdownTime = 0;
           finalKeypadAmount = "";
           isAmount = false;
         }
        }



        }*/

      //        } else {
      //          Serial.println("Invalid input. Please enter a valid amount.");
      //        }
      memset(buffer, 0, sizeof(buffer));                                                   // Clear buffer for next reading
      //dwinSerial.write(ResetAmt, 11);

    }

    if (countdownTime == 0) {

      if (hmi.getPage() == 11) {                                                          // Checking for power off page
        Serial.println("Powering off checking");
        Serial.flush();
        dwinSerial.write(offDisplay, 7);
        Serial2.println("AT+QPOWD = 1");
        Serial.println("Powering off");
        // delay(1000);
        esp_deep_sleep_start();
      }
      else if (hmi.getPage() == 14) {                                                    // Checking for restart page
        Serial.println("restarting checking");
        Serial.println("Restarting the system");
        // delay(1000);
        Serial.flush();
        ESP.restart();
      }
    }
    if (hmi.getBrightness() == 0 && messageBuffer[1] == "" && messageBuffer[0] == "")   // Checking to on sleep mode
    {
      battery_measurement();
      pageno = hmi.getPage();
      pref.putInt("pageno", pageno);
      setPage(00);
      Serial2.println("AT+CFUN=0");                                                    // Setting minimum functionality
      updateSerial();
      delay(50);
      Serial.println("Going to sleep now");
      esp_deep_sleep_start();
    }
  }
}
/******************************* receiving_Amount() function end **************************************************************/

/******************************* Generating QR code with specified amount *****************************************************/
void generateAmountQRCode(String amount) {
  //  dwinSerial.write(ResetAmt, 11);                                              // resetting amount to 0 on display
  //  Serial.println("resetting amount");
  // Construct UPI payment link with dynamic amount
  String upiLink = "upi://pay?pa=" + upiID + "&pn=" + userName + "&am=" + amount + "&cu=" + currency;
  Serial.println(upiLink);

  uint8_t Vari[6] = {0x5A, 0xA5, 0x00, 0x82, 0x12, 0x00};
  char hexs[500];  // Array to store hex values as bytes
  int j = 0;

  for (int i = 0; i < upiLink.length(); i++) {
    sprintf(hexs + j, "%02X", upiLink[i]);                                          // Format each character as two hexadecimal digits without "0x"
    j += 2; // Each hex value is 2 characters long
  }
  hexs[j] = '\0';  // Null-terminate the string
  // Update the length byte in Vari1 to match the size of the data being sent
  Vari[2] = upiLink.length() + 6;                                                   // Adjust length for the DWIN display protocol

  // Send the header bytes
  dwinSerial.write(Vari, 6);

  // Send hex values as bytes
  for (int i = 0; i < strlen(hexs); i += 2) {
    // Convert each two-character hex pair back into a byte
    char hexPair[3] = {hexs[i], hexs[i + 1], '\0'};
    uint8_t byteValue = (uint8_t)strtol(hexPair, NULL, 16);
    dwinSerial.write(byteValue);                                                     // Send the byte over UART
  }
  dwinSerial.write(terminator, 3);

  memset(hexs, 0, sizeof(hexs));                                                     // Clear the hex string buffer

  //  Serial.println("Resetting value to '0'");
  //  dwinSerial.write(ResetAmt, 11);
}
/************************************* generateAmountQRCode(String amount) function end **************************************/

/************************************* Erasing text on DWIN display **********************************************************/
void eraseText(int vpaddress, int textLength) {
  dwinSerial.write(0x5A);
  dwinSerial.write(0xA5);
  dwinSerial.write(3 + textLength);
  dwinSerial.write(0x82);
  dwinSerial.write(lowByte(vpaddress));
  dwinSerial.write(highByte(vpaddress));

  for (int i = 0; i < textLength; i++) {
    dwinSerial.write((byte)0x20);                                                   // Clearing the text on display at given address
  }
}
/************************************* eraseText(int vpaddress, int textLength) function end *********************************/

/************************************* Generating default QR code ************************************************************/
void generateDefaultQrpage() {
  // Construct UPI payment link with dynamic amount
  String upiLink = "upi://pay?pa=" + upiID + "&pn=" + userName;
  //Serial.println(upiLink);

  uint8_t Vari[6] = {0x5A, 0xA5, 0x00, 0x82, 0X11, 0x00};
  char hexs[500];                                                                  // Array to store hex values as bytes
  int j = 0;

  for (int i = 0; i < upiLink.length(); i++) {
    sprintf(hexs + j, "%02X", upiLink[i]);                                         // Format each character as two hexadecimal digits without "0x"
    j += 2; // Each hex value is 2 characters long
  }
  hexs[j] = '\0';  // Null-terminate the string
                                                                                   // Update the length byte in Vari1 to match the size of the data being sent
  Vari[2] = upiLink.length() + 6;                                                  // Adjust length for the DWIN display protocol

  dwinSerial.write(Vari, 6);                                                       // Send the header bytes           

  // Send hex values as bytes
  for (int i = 0; i < strlen(hexs); i += 2) {
    char hexPair[3] = {hexs[i], hexs[i + 1], '\0'};                               // Convert each two-character hex pair back into a byte
    uint8_t byteValue = (uint8_t)strtol(hexPair, NULL, 16);
    dwinSerial.write(byteValue);                                                   // Send the byte over UART
  }
  dwinSerial.write(terminator, 3);                                                // sending terminator to avoid conflict for next QR
}
/********************************** generateDefaultQrpage() function end *****************************************************/

/********************************** Volume Adjustment Functions **************************************************************/
void setVolume(int volume) {
  volume = constrain(volume, 0, 100);                                               // Ensure volume is within range
  audio.setVolume(volume);
  Serial.printf("Volume set to: %d\n", volume);
}
/********************************** setVolume(int volume) function end *******************************************************/

/********************************** Function to increase volume **************************************************************/
void increaseVolume() {
  currentVolume += 10;
  dwinSerial.write(simulateTouch, 14);
  if (currentVolume > 100) currentVolume = 100;
  setVolume(currentVolume);
  sendTextAscii(0x58, String(currentVolume));                                        // Sending volume update on display
  sendTextAscii(0x59, "VOL");
  delay(1000);
  eraseText(0x58, 4);                                                                // Erasing volume update on display
  eraseText(0x59, 4);
}
/*********************************** increaseVolume() function end ************************************************************/

/*********************************** Function to decrease volume *************************************************************/
void decreaseVolume() {
  currentVolume -= 10;
  dwinSerial.write(simulateTouch, 14);
  if (currentVolume < 0) currentVolume = 0;
  setVolume(currentVolume);
  sendTextAscii(0x58, String(currentVolume));                                         // Sending volume update on display
  sendTextAscii(0x59, "VOL");
  delay(1000);
  eraseText(0x58, 4);                                                                 // Erasing volume on display
  eraseText(0x59, 4);
}
/*********************************** decreaseVolume() function end ************************************************************/

/*********************************** Displaying network on display ***********************************************************/
void displayNetwork(bool networkAvailable) {
  unsigned char   Network[8] = {0x5A, 0xA5, 0x05, 0x82, 0x55, 0x00, 0x00, 0x00};       // Command for displaying network
  if (networkAvailable == true) {
    Network[7] = 0x00;                                                                 // if network connected
    dwinSerial.write(Network, 8);
  }
  else {
    Network[7] = 0x01;                                                                 // if network not connected
    dwinSerial.write(Network, 8);
  }
}
/*********************************** displayNetwork(bool networkAvailable) function end **************************************/

/*********************************** Displaying battery percentage on DWIN display *******************************************/
void displayBattery() {
  int batPer = batperc;
  sendTextAscii(0x68, String(batPer));                                                  // Sending battery percentage
}
/********************************* displayBattery() function end *************************************************************/

/********************************* Displaying battery charging status ********************************************************/
void chargingStatus(bool charging) {
  unsigned char   Charging[8] = {0x5A, 0xA5, 0x05, 0x82, 0x60, 0x00, 0x00, 0x00};
  if (charging == true) {
    Charging[7] = 0x00;                                                                // If charging on
    dwinSerial.write(Charging, 8);
  }
  else {
    Charging[7] = 0x01;                                                                // If charging off
    dwinSerial.write(Charging, 8);
  }
}
/********************************* chargingStatus(bool charging) *************************************************************/

/********************************* Sending text on DWIN display **************************************************************/
void sendTextAscii(int vpaddress, String s) {
  //eraseText(vpaddress, 100);
  unsigned char Vari[7] = {0x5A, 0xA5, 0x00, 0x82, vpaddress, (byte)0x00, 0x20};

  char hexs[500];                                                                 // Array to store hex values as bytes
  int j = 0;

  for (int i = 0; i < s.length(); i++) {
    sprintf(hexs + j, "%02X", s[i]);                                              // Format each character as two hexadecimal digits without "0x"
    j += 2;                                                                       // Each hex value is 2 characters long
  }
  hexs[j] = '\0';  // Null-terminate the string
  // Update the length byte in Vari1 to match the size of the data being sent
  Vari[2] = s.length() + 6;                                                       // Adjust length for the DWIN display protocol

  // Send the header bytes
  dwinSerial.write(Vari, 6);

  // Send hex values as bytes
  for (int i = 0; i < strlen(hexs); i += 2) {
    // Convert each two-character hex pair back into a byte
    char hexPair[3] = {hexs[i], hexs[i + 1], '\0'};
    uint8_t byteValue = (uint8_t)strtol(hexPair, NULL, 16);
    dwinSerial.write(byteValue);                                                    // Send the byte over UART
  }
  dwinSerial.write(terminator, 3);
  //memset(Vari, 0, sizeof(Vari));                                                  // clearing the buffer
}
/******************************** sendTextAscii(int vpaddress, String s) function end ****************************************/

/******************************** Device bluetooth on indication *************************************************************/
void displayBle(bool bleMode) {
  unsigned char   Ble[8] = {0x5A, 0xA5, 0x05, 0x82, 0x56, 0x00, 0x00, 0x00};
  if (bleMode == true) {
    Ble[7] = 0x00;                                                                      // If bluetooth on
    dwinSerial.write(Ble, 8);
  }
  else {
    Ble[7] = 0x01;                                                                      // If bluetooth off
    dwinSerial.write(Ble, 8);
  }
}
/******************************** displayBle(bool bleMode) function end *******************************************************/

/******************************** Setting page of display *********************************************************************/
byte setPage(uint8_t pageNum)
{
  unsigned char command[10] = {0x5A, 0xA5, 0x07, 0x82, 0x00, 0x84, 0x5A, 0x01, 0x00, pageNum};
  // Send data to uartTask
  dwinSerial.write(command, 10);                                                           // Setting page on display
}
/******************************** setPage(uint8_t pageNum) function end *******************************************************/

/******************************** Saving time of received transactions ********************************************************/
void savetime() {
  getMsgcnt();

  if (Msg_cnt == 1) {
    pref.putString("time1", preTime + " on " + date);                                     // Saving time of arrived message
  }
  else if (Msg_cnt == 2) {
    pref.putString("time2", preTime + " on " + date);
  }
  else if (Msg_cnt == 3) {
    pref.putString("time3", preTime + " on " + date);
  }
  else if (Msg_cnt == 4) {
    pref.putString("time4", preTime + " on " + date);
  }
  else if (Msg_cnt == 5) {
    pref.putString("time5", preTime + " on " + date);
  }
}
/******************************* savetime() function end **********************************************************************/

/******************************** Displaying transaction on display ***********************************************************/
void displaytransaction() {
  getMsgcnt();
  String preTran = "";
  String res = "";

  // Define keys and ASCII mappings
  const char* timeKeys[5] = {"time1", "time2", "time3", "time4", "time5"};             // variables of time details
  const char* strKeys[5] = {"str1", "str2", "str3", "str4", "str5"};
  uint8_t timeAscii[5] = {0x36, 0x37, 0x38, 0x39, 0x40};                               // vp addresses of time
  uint8_t strAscii[5] = {0x22, 0x23, 0x24, 0x25, 0x26};

  // Predefined sequences for each Msg_cnt
  const int sequences[5][5] = {
    {0, 4, 3, 2, 1},                                                                  // Msg_cnt == 1
    {1, 0, 4, 3, 2},                                                                  // Msg_cnt == 2
    {2, 1, 0, 4, 3},                                                                  // Msg_cnt == 3
    {3, 2, 1, 0, 4},                                                                  // Msg_cnt == 4
    {4, 3, 2, 1, 0}                                                                   // Msg_cnt == 5
  };

  // Validate Msg_cnt range (1 to 5)
  if (Msg_cnt < 1 || Msg_cnt > 5) {
    Serial.println("Invalid Msg_cnt!");
    return;
  }

  // Display messages based on the sequence
  for (int i = 0; i < 5; i++) {
    int index = sequences[Msg_cnt - 1][i];

    res = pref.getString(timeKeys[index], preTran);                                  // getting time of transaction
    sendTextAscii(timeAscii[i], res);                                                // sending time
                       
    res = pref.getString(strKeys[index], preTran);                                   // getting transaction amount
    sendTextAscii(strAscii[i], currency + " " + res);                                // sending amount
  }
}
/**************************** displaytransaction() function end ***************************************************************/

/**************************** Configuring cellular module with AT commands ****************************************************/
void configModule() {
  Serial2.println("AT+CMGF=1");                                                       //Setting SMS mode
  updateSerial();
  Serial2.println("AT+QURCCFG=\"URCPORT\", \"UART1\"");                               //For UART communication
  updateSerial();
  Serial2.println("AT+CNMI=1,2,0,0,0");                                               //setting the message service to storage or not
  updateSerial();
  Serial2.println("AT+QSIMDET=1,0");                                                  //SIM detection, if SIM removed- +CPIN: NOT READY, SIM inserted- READY
  //  Serial2.println("AT+QSCLK=1");                                                  //enabling sleep mode
  //  updateSerial();
  Serial2.println("AT+QSCLKEX=1,2,5");                                                //enabling sleep mode
  updateSerial();
  Serial2.println("AT+QGPSEND");                                                      //disabling GPS
  updateSerial();
  Serial2.println("AT+QGPS?");                                                        //GPS STATUS
  updateSerial();
  Serial2.println("AT+CTZU=3");                                                       //Timing zone and reporting
  updateSerial();
  Serial2.println("AT+CCLK?");                                                        //Getting time
  updateSerial();
}
/***************************** configModule() function end ********************************************************************/
